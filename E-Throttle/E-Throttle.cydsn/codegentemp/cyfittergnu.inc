.ifndef INCLUDED_CYFITTERGNU_INC
.set INCLUDED_CYFITTERGNU_INC, 1
.include "cydevicegnu.inc"
.include "cydevicegnu_trm.inc"

/* Brake */
.set Brake__0__MASK, 0x04
.set Brake__0__PC, CYREG_PRT2_PC2
.set Brake__0__PORT, 2
.set Brake__0__SHIFT, 2
.set Brake__AG, CYREG_PRT2_AG
.set Brake__AMUX, CYREG_PRT2_AMUX
.set Brake__BIE, CYREG_PRT2_BIE
.set Brake__BIT_MASK, CYREG_PRT2_BIT_MASK
.set Brake__BYP, CYREG_PRT2_BYP
.set Brake__CTL, CYREG_PRT2_CTL
.set Brake__DM0, CYREG_PRT2_DM0
.set Brake__DM1, CYREG_PRT2_DM1
.set Brake__DM2, CYREG_PRT2_DM2
.set Brake__DR, CYREG_PRT2_DR
.set Brake__INP_DIS, CYREG_PRT2_INP_DIS
.set Brake__LCD_COM_SEG, CYREG_PRT2_LCD_COM_SEG
.set Brake__LCD_EN, CYREG_PRT2_LCD_EN
.set Brake__MASK, 0x04
.set Brake__PORT, 2
.set Brake__PRT, CYREG_PRT2_PRT
.set Brake__PRTDSI__CAPS_SEL, CYREG_PRT2_CAPS_SEL
.set Brake__PRTDSI__DBL_SYNC_IN, CYREG_PRT2_DBL_SYNC_IN
.set Brake__PRTDSI__OE_SEL0, CYREG_PRT2_OE_SEL0
.set Brake__PRTDSI__OE_SEL1, CYREG_PRT2_OE_SEL1
.set Brake__PRTDSI__OUT_SEL0, CYREG_PRT2_OUT_SEL0
.set Brake__PRTDSI__OUT_SEL1, CYREG_PRT2_OUT_SEL1
.set Brake__PRTDSI__SYNC_OUT, CYREG_PRT2_SYNC_OUT
.set Brake__PS, CYREG_PRT2_PS
.set Brake__SHIFT, 2
.set Brake__SLW, CYREG_PRT2_SLW

/* TPS_0 */
.set TPS_0__0__MASK, 0x10
.set TPS_0__0__PC, CYREG_IO_PC_PRT15_PC4
.set TPS_0__0__PORT, 15
.set TPS_0__0__SHIFT, 4
.set TPS_0__AG, CYREG_PRT15_AG
.set TPS_0__AMUX, CYREG_PRT15_AMUX
.set TPS_0__BIE, CYREG_PRT15_BIE
.set TPS_0__BIT_MASK, CYREG_PRT15_BIT_MASK
.set TPS_0__BYP, CYREG_PRT15_BYP
.set TPS_0__CTL, CYREG_PRT15_CTL
.set TPS_0__DM0, CYREG_PRT15_DM0
.set TPS_0__DM1, CYREG_PRT15_DM1
.set TPS_0__DM2, CYREG_PRT15_DM2
.set TPS_0__DR, CYREG_PRT15_DR
.set TPS_0__INP_DIS, CYREG_PRT15_INP_DIS
.set TPS_0__LCD_COM_SEG, CYREG_PRT15_LCD_COM_SEG
.set TPS_0__LCD_EN, CYREG_PRT15_LCD_EN
.set TPS_0__MASK, 0x10
.set TPS_0__PORT, 15
.set TPS_0__PRT, CYREG_PRT15_PRT
.set TPS_0__PRTDSI__CAPS_SEL, CYREG_PRT15_CAPS_SEL
.set TPS_0__PRTDSI__DBL_SYNC_IN, CYREG_PRT15_DBL_SYNC_IN
.set TPS_0__PRTDSI__OE_SEL0, CYREG_PRT15_OE_SEL0
.set TPS_0__PRTDSI__OE_SEL1, CYREG_PRT15_OE_SEL1
.set TPS_0__PRTDSI__OUT_SEL0, CYREG_PRT15_OUT_SEL0
.set TPS_0__PRTDSI__OUT_SEL1, CYREG_PRT15_OUT_SEL1
.set TPS_0__PRTDSI__SYNC_OUT, CYREG_PRT15_SYNC_OUT
.set TPS_0__PS, CYREG_PRT15_PS
.set TPS_0__SHIFT, 4
.set TPS_0__SLW, CYREG_PRT15_SLW

/* TPS_1 */
.set TPS_1__0__MASK, 0x20
.set TPS_1__0__PC, CYREG_IO_PC_PRT15_PC5
.set TPS_1__0__PORT, 15
.set TPS_1__0__SHIFT, 5
.set TPS_1__AG, CYREG_PRT15_AG
.set TPS_1__AMUX, CYREG_PRT15_AMUX
.set TPS_1__BIE, CYREG_PRT15_BIE
.set TPS_1__BIT_MASK, CYREG_PRT15_BIT_MASK
.set TPS_1__BYP, CYREG_PRT15_BYP
.set TPS_1__CTL, CYREG_PRT15_CTL
.set TPS_1__DM0, CYREG_PRT15_DM0
.set TPS_1__DM1, CYREG_PRT15_DM1
.set TPS_1__DM2, CYREG_PRT15_DM2
.set TPS_1__DR, CYREG_PRT15_DR
.set TPS_1__INP_DIS, CYREG_PRT15_INP_DIS
.set TPS_1__LCD_COM_SEG, CYREG_PRT15_LCD_COM_SEG
.set TPS_1__LCD_EN, CYREG_PRT15_LCD_EN
.set TPS_1__MASK, 0x20
.set TPS_1__PORT, 15
.set TPS_1__PRT, CYREG_PRT15_PRT
.set TPS_1__PRTDSI__CAPS_SEL, CYREG_PRT15_CAPS_SEL
.set TPS_1__PRTDSI__DBL_SYNC_IN, CYREG_PRT15_DBL_SYNC_IN
.set TPS_1__PRTDSI__OE_SEL0, CYREG_PRT15_OE_SEL0
.set TPS_1__PRTDSI__OE_SEL1, CYREG_PRT15_OE_SEL1
.set TPS_1__PRTDSI__OUT_SEL0, CYREG_PRT15_OUT_SEL0
.set TPS_1__PRTDSI__OUT_SEL1, CYREG_PRT15_OUT_SEL1
.set TPS_1__PRTDSI__SYNC_OUT, CYREG_PRT15_SYNC_OUT
.set TPS_1__PS, CYREG_PRT15_PS
.set TPS_1__SHIFT, 5
.set TPS_1__SLW, CYREG_PRT15_SLW

/* APPS_0 */
.set APPS_0__0__MASK, 0x01
.set APPS_0__0__PC, CYREG_PRT2_PC0
.set APPS_0__0__PORT, 2
.set APPS_0__0__SHIFT, 0
.set APPS_0__AG, CYREG_PRT2_AG
.set APPS_0__AMUX, CYREG_PRT2_AMUX
.set APPS_0__BIE, CYREG_PRT2_BIE
.set APPS_0__BIT_MASK, CYREG_PRT2_BIT_MASK
.set APPS_0__BYP, CYREG_PRT2_BYP
.set APPS_0__CTL, CYREG_PRT2_CTL
.set APPS_0__DM0, CYREG_PRT2_DM0
.set APPS_0__DM1, CYREG_PRT2_DM1
.set APPS_0__DM2, CYREG_PRT2_DM2
.set APPS_0__DR, CYREG_PRT2_DR
.set APPS_0__INP_DIS, CYREG_PRT2_INP_DIS
.set APPS_0__LCD_COM_SEG, CYREG_PRT2_LCD_COM_SEG
.set APPS_0__LCD_EN, CYREG_PRT2_LCD_EN
.set APPS_0__MASK, 0x01
.set APPS_0__PORT, 2
.set APPS_0__PRT, CYREG_PRT2_PRT
.set APPS_0__PRTDSI__CAPS_SEL, CYREG_PRT2_CAPS_SEL
.set APPS_0__PRTDSI__DBL_SYNC_IN, CYREG_PRT2_DBL_SYNC_IN
.set APPS_0__PRTDSI__OE_SEL0, CYREG_PRT2_OE_SEL0
.set APPS_0__PRTDSI__OE_SEL1, CYREG_PRT2_OE_SEL1
.set APPS_0__PRTDSI__OUT_SEL0, CYREG_PRT2_OUT_SEL0
.set APPS_0__PRTDSI__OUT_SEL1, CYREG_PRT2_OUT_SEL1
.set APPS_0__PRTDSI__SYNC_OUT, CYREG_PRT2_SYNC_OUT
.set APPS_0__PS, CYREG_PRT2_PS
.set APPS_0__SHIFT, 0
.set APPS_0__SLW, CYREG_PRT2_SLW

/* APPS_1 */
.set APPS_1__0__MASK, 0x02
.set APPS_1__0__PC, CYREG_PRT2_PC1
.set APPS_1__0__PORT, 2
.set APPS_1__0__SHIFT, 1
.set APPS_1__AG, CYREG_PRT2_AG
.set APPS_1__AMUX, CYREG_PRT2_AMUX
.set APPS_1__BIE, CYREG_PRT2_BIE
.set APPS_1__BIT_MASK, CYREG_PRT2_BIT_MASK
.set APPS_1__BYP, CYREG_PRT2_BYP
.set APPS_1__CTL, CYREG_PRT2_CTL
.set APPS_1__DM0, CYREG_PRT2_DM0
.set APPS_1__DM1, CYREG_PRT2_DM1
.set APPS_1__DM2, CYREG_PRT2_DM2
.set APPS_1__DR, CYREG_PRT2_DR
.set APPS_1__INP_DIS, CYREG_PRT2_INP_DIS
.set APPS_1__LCD_COM_SEG, CYREG_PRT2_LCD_COM_SEG
.set APPS_1__LCD_EN, CYREG_PRT2_LCD_EN
.set APPS_1__MASK, 0x02
.set APPS_1__PORT, 2
.set APPS_1__PRT, CYREG_PRT2_PRT
.set APPS_1__PRTDSI__CAPS_SEL, CYREG_PRT2_CAPS_SEL
.set APPS_1__PRTDSI__DBL_SYNC_IN, CYREG_PRT2_DBL_SYNC_IN
.set APPS_1__PRTDSI__OE_SEL0, CYREG_PRT2_OE_SEL0
.set APPS_1__PRTDSI__OE_SEL1, CYREG_PRT2_OE_SEL1
.set APPS_1__PRTDSI__OUT_SEL0, CYREG_PRT2_OUT_SEL0
.set APPS_1__PRTDSI__OUT_SEL1, CYREG_PRT2_OUT_SEL1
.set APPS_1__PRTDSI__SYNC_OUT, CYREG_PRT2_SYNC_OUT
.set APPS_1__PS, CYREG_PRT2_PS
.set APPS_1__SHIFT, 1
.set APPS_1__SLW, CYREG_PRT2_SLW

/* Clock_1 */
.set Clock_1__CFG0, CYREG_CLKDIST_DCFG1_CFG0
.set Clock_1__CFG1, CYREG_CLKDIST_DCFG1_CFG1
.set Clock_1__CFG2, CYREG_CLKDIST_DCFG1_CFG2
.set Clock_1__CFG2_SRC_SEL_MASK, 0x07
.set Clock_1__INDEX, 0x01
.set Clock_1__PM_ACT_CFG, CYREG_PM_ACT_CFG2
.set Clock_1__PM_ACT_MSK, 0x02
.set Clock_1__PM_STBY_CFG, CYREG_PM_STBY_CFG2
.set Clock_1__PM_STBY_MSK, 0x02

/* TPS_ADC_bSAR_SEQ */
.set TPS_ADC_bSAR_SEQ_ChannelCounter__16BIT_CONTROL_AUX_CTL_REG, CYREG_B0_UDB08_09_ACTL
.set TPS_ADC_bSAR_SEQ_ChannelCounter__16BIT_CONTROL_CONTROL_REG, CYREG_B0_UDB08_09_CTL
.set TPS_ADC_bSAR_SEQ_ChannelCounter__16BIT_CONTROL_COUNT_REG, CYREG_B0_UDB08_09_CTL
.set TPS_ADC_bSAR_SEQ_ChannelCounter__16BIT_COUNT_CONTROL_REG, CYREG_B0_UDB08_09_CTL
.set TPS_ADC_bSAR_SEQ_ChannelCounter__16BIT_COUNT_COUNT_REG, CYREG_B0_UDB08_09_CTL
.set TPS_ADC_bSAR_SEQ_ChannelCounter__16BIT_MASK_MASK_REG, CYREG_B0_UDB08_09_MSK
.set TPS_ADC_bSAR_SEQ_ChannelCounter__16BIT_MASK_PERIOD_REG, CYREG_B0_UDB08_09_MSK
.set TPS_ADC_bSAR_SEQ_ChannelCounter__16BIT_PERIOD_MASK_REG, CYREG_B0_UDB08_09_MSK
.set TPS_ADC_bSAR_SEQ_ChannelCounter__16BIT_PERIOD_PERIOD_REG, CYREG_B0_UDB08_09_MSK
.set TPS_ADC_bSAR_SEQ_ChannelCounter__CONTROL_AUX_CTL_REG, CYREG_B0_UDB08_ACTL
.set TPS_ADC_bSAR_SEQ_ChannelCounter__CONTROL_REG, CYREG_B0_UDB08_CTL
.set TPS_ADC_bSAR_SEQ_ChannelCounter__CONTROL_ST_REG, CYREG_B0_UDB08_ST_CTL
.set TPS_ADC_bSAR_SEQ_ChannelCounter__COUNT_REG, CYREG_B0_UDB08_CTL
.set TPS_ADC_bSAR_SEQ_ChannelCounter__COUNT_ST_REG, CYREG_B0_UDB08_ST_CTL
.set TPS_ADC_bSAR_SEQ_ChannelCounter__MASK_CTL_AUX_CTL_REG, CYREG_B0_UDB08_MSK_ACTL
.set TPS_ADC_bSAR_SEQ_ChannelCounter__PER_CTL_AUX_CTL_REG, CYREG_B0_UDB08_MSK_ACTL
.set TPS_ADC_bSAR_SEQ_ChannelCounter__PERIOD_REG, CYREG_B0_UDB08_MSK
.set TPS_ADC_bSAR_SEQ_ChannelCounter_ST__16BIT_STATUS_AUX_CTL_REG, CYREG_B0_UDB08_09_ACTL
.set TPS_ADC_bSAR_SEQ_ChannelCounter_ST__16BIT_STATUS_REG, CYREG_B0_UDB08_09_ST
.set TPS_ADC_bSAR_SEQ_ChannelCounter_ST__MASK_REG, CYREG_B0_UDB08_MSK
.set TPS_ADC_bSAR_SEQ_ChannelCounter_ST__MASK_ST_AUX_CTL_REG, CYREG_B0_UDB08_MSK_ACTL
.set TPS_ADC_bSAR_SEQ_ChannelCounter_ST__PER_ST_AUX_CTL_REG, CYREG_B0_UDB08_MSK_ACTL
.set TPS_ADC_bSAR_SEQ_ChannelCounter_ST__STATUS_AUX_CTL_REG, CYREG_B0_UDB08_ACTL
.set TPS_ADC_bSAR_SEQ_ChannelCounter_ST__STATUS_CNT_REG, CYREG_B0_UDB08_ST_CTL
.set TPS_ADC_bSAR_SEQ_ChannelCounter_ST__STATUS_CONTROL_REG, CYREG_B0_UDB08_ST_CTL
.set TPS_ADC_bSAR_SEQ_ChannelCounter_ST__STATUS_REG, CYREG_B0_UDB08_ST
.set TPS_ADC_bSAR_SEQ_CtrlReg__0__MASK, 0x01
.set TPS_ADC_bSAR_SEQ_CtrlReg__0__POS, 0
.set TPS_ADC_bSAR_SEQ_CtrlReg__1__MASK, 0x02
.set TPS_ADC_bSAR_SEQ_CtrlReg__1__POS, 1
.set TPS_ADC_bSAR_SEQ_CtrlReg__16BIT_CONTROL_AUX_CTL_REG, CYREG_B1_UDB08_09_ACTL
.set TPS_ADC_bSAR_SEQ_CtrlReg__16BIT_CONTROL_CONTROL_REG, CYREG_B1_UDB08_09_CTL
.set TPS_ADC_bSAR_SEQ_CtrlReg__16BIT_CONTROL_COUNT_REG, CYREG_B1_UDB08_09_CTL
.set TPS_ADC_bSAR_SEQ_CtrlReg__16BIT_COUNT_CONTROL_REG, CYREG_B1_UDB08_09_CTL
.set TPS_ADC_bSAR_SEQ_CtrlReg__16BIT_COUNT_COUNT_REG, CYREG_B1_UDB08_09_CTL
.set TPS_ADC_bSAR_SEQ_CtrlReg__16BIT_MASK_MASK_REG, CYREG_B1_UDB08_09_MSK
.set TPS_ADC_bSAR_SEQ_CtrlReg__16BIT_MASK_PERIOD_REG, CYREG_B1_UDB08_09_MSK
.set TPS_ADC_bSAR_SEQ_CtrlReg__16BIT_PERIOD_MASK_REG, CYREG_B1_UDB08_09_MSK
.set TPS_ADC_bSAR_SEQ_CtrlReg__16BIT_PERIOD_PERIOD_REG, CYREG_B1_UDB08_09_MSK
.set TPS_ADC_bSAR_SEQ_CtrlReg__2__MASK, 0x04
.set TPS_ADC_bSAR_SEQ_CtrlReg__2__POS, 2
.set TPS_ADC_bSAR_SEQ_CtrlReg__CONTROL_AUX_CTL_REG, CYREG_B1_UDB08_ACTL
.set TPS_ADC_bSAR_SEQ_CtrlReg__CONTROL_REG, CYREG_B1_UDB08_CTL
.set TPS_ADC_bSAR_SEQ_CtrlReg__CONTROL_ST_REG, CYREG_B1_UDB08_ST_CTL
.set TPS_ADC_bSAR_SEQ_CtrlReg__COUNT_REG, CYREG_B1_UDB08_CTL
.set TPS_ADC_bSAR_SEQ_CtrlReg__COUNT_ST_REG, CYREG_B1_UDB08_ST_CTL
.set TPS_ADC_bSAR_SEQ_CtrlReg__MASK, 0x07
.set TPS_ADC_bSAR_SEQ_CtrlReg__MASK_CTL_AUX_CTL_REG, CYREG_B1_UDB08_MSK_ACTL
.set TPS_ADC_bSAR_SEQ_CtrlReg__PER_CTL_AUX_CTL_REG, CYREG_B1_UDB08_MSK_ACTL
.set TPS_ADC_bSAR_SEQ_CtrlReg__PERIOD_REG, CYREG_B1_UDB08_MSK
.set TPS_ADC_bSAR_SEQ_EOCSts__0__MASK, 0x01
.set TPS_ADC_bSAR_SEQ_EOCSts__0__POS, 0
.set TPS_ADC_bSAR_SEQ_EOCSts__MASK, 0x01
.set TPS_ADC_bSAR_SEQ_EOCSts__MASK_REG, CYREG_B1_UDB11_MSK
.set TPS_ADC_bSAR_SEQ_EOCSts__STATUS_AUX_CTL_REG, CYREG_B1_UDB11_ACTL
.set TPS_ADC_bSAR_SEQ_EOCSts__STATUS_REG, CYREG_B1_UDB11_ST

/* TPS_ADC_FinalBuf */
.set TPS_ADC_FinalBuf__DRQ_CTL, CYREG_IDMUX_DRQ_CTL0
.set TPS_ADC_FinalBuf__DRQ_NUMBER, 2
.set TPS_ADC_FinalBuf__NUMBEROF_TDS, 0
.set TPS_ADC_FinalBuf__PRIORITY, 2
.set TPS_ADC_FinalBuf__TERMIN_EN, 0
.set TPS_ADC_FinalBuf__TERMIN_SEL, 0
.set TPS_ADC_FinalBuf__TERMOUT0_EN, 1
.set TPS_ADC_FinalBuf__TERMOUT0_SEL, 2
.set TPS_ADC_FinalBuf__TERMOUT1_EN, 0
.set TPS_ADC_FinalBuf__TERMOUT1_SEL, 0

/* TPS_ADC_IntClock */
.set TPS_ADC_IntClock__CFG0, CYREG_CLKDIST_DCFG2_CFG0
.set TPS_ADC_IntClock__CFG1, CYREG_CLKDIST_DCFG2_CFG1
.set TPS_ADC_IntClock__CFG2, CYREG_CLKDIST_DCFG2_CFG2
.set TPS_ADC_IntClock__CFG2_SRC_SEL_MASK, 0x07
.set TPS_ADC_IntClock__INDEX, 0x02
.set TPS_ADC_IntClock__PM_ACT_CFG, CYREG_PM_ACT_CFG2
.set TPS_ADC_IntClock__PM_ACT_MSK, 0x04
.set TPS_ADC_IntClock__PM_STBY_CFG, CYREG_PM_STBY_CFG2
.set TPS_ADC_IntClock__PM_STBY_MSK, 0x04

/* TPS_ADC_IRQ */
.set TPS_ADC_IRQ__INTC_CLR_EN_REG, CYREG_NVIC_CLRENA0
.set TPS_ADC_IRQ__INTC_CLR_PD_REG, CYREG_NVIC_CLRPEND0
.set TPS_ADC_IRQ__INTC_MASK, 0x02
.set TPS_ADC_IRQ__INTC_NUMBER, 1
.set TPS_ADC_IRQ__INTC_PRIOR_NUM, 7
.set TPS_ADC_IRQ__INTC_PRIOR_REG, CYREG_NVIC_PRI_1
.set TPS_ADC_IRQ__INTC_SET_EN_REG, CYREG_NVIC_SETENA0
.set TPS_ADC_IRQ__INTC_SET_PD_REG, CYREG_NVIC_SETPEND0

/* TPS_ADC_SAR_ADC_SAR */
.set TPS_ADC_SAR_ADC_SAR__CLK, CYREG_SAR0_CLK
.set TPS_ADC_SAR_ADC_SAR__CSR0, CYREG_SAR0_CSR0
.set TPS_ADC_SAR_ADC_SAR__CSR1, CYREG_SAR0_CSR1
.set TPS_ADC_SAR_ADC_SAR__CSR2, CYREG_SAR0_CSR2
.set TPS_ADC_SAR_ADC_SAR__CSR3, CYREG_SAR0_CSR3
.set TPS_ADC_SAR_ADC_SAR__CSR4, CYREG_SAR0_CSR4
.set TPS_ADC_SAR_ADC_SAR__CSR5, CYREG_SAR0_CSR5
.set TPS_ADC_SAR_ADC_SAR__CSR6, CYREG_SAR0_CSR6
.set TPS_ADC_SAR_ADC_SAR__PM_ACT_CFG, CYREG_PM_ACT_CFG11
.set TPS_ADC_SAR_ADC_SAR__PM_ACT_MSK, 0x01
.set TPS_ADC_SAR_ADC_SAR__PM_STBY_CFG, CYREG_PM_STBY_CFG11
.set TPS_ADC_SAR_ADC_SAR__PM_STBY_MSK, 0x01
.set TPS_ADC_SAR_ADC_SAR__SW0, CYREG_SAR0_SW0
.set TPS_ADC_SAR_ADC_SAR__SW2, CYREG_SAR0_SW2
.set TPS_ADC_SAR_ADC_SAR__SW3, CYREG_SAR0_SW3
.set TPS_ADC_SAR_ADC_SAR__SW4, CYREG_SAR0_SW4
.set TPS_ADC_SAR_ADC_SAR__SW6, CYREG_SAR0_SW6
.set TPS_ADC_SAR_ADC_SAR__TR0, CYREG_SAR0_TR0
.set TPS_ADC_SAR_ADC_SAR__WRK0, CYREG_SAR0_WRK0
.set TPS_ADC_SAR_ADC_SAR__WRK1, CYREG_SAR0_WRK1

/* TPS_ADC_TempBuf */
.set TPS_ADC_TempBuf__DRQ_CTL, CYREG_IDMUX_DRQ_CTL0
.set TPS_ADC_TempBuf__DRQ_NUMBER, 3
.set TPS_ADC_TempBuf__NUMBEROF_TDS, 0
.set TPS_ADC_TempBuf__PRIORITY, 2
.set TPS_ADC_TempBuf__TERMIN_EN, 0
.set TPS_ADC_TempBuf__TERMIN_SEL, 0
.set TPS_ADC_TempBuf__TERMOUT0_EN, 1
.set TPS_ADC_TempBuf__TERMOUT0_SEL, 3
.set TPS_ADC_TempBuf__TERMOUT1_EN, 0
.set TPS_ADC_TempBuf__TERMOUT1_SEL, 0

/* APPS_ADC_bSAR_SEQ */
.set APPS_ADC_bSAR_SEQ_ChannelCounter__16BIT_CONTROL_AUX_CTL_REG, CYREG_B0_UDB04_05_ACTL
.set APPS_ADC_bSAR_SEQ_ChannelCounter__16BIT_CONTROL_CONTROL_REG, CYREG_B0_UDB04_05_CTL
.set APPS_ADC_bSAR_SEQ_ChannelCounter__16BIT_CONTROL_COUNT_REG, CYREG_B0_UDB04_05_CTL
.set APPS_ADC_bSAR_SEQ_ChannelCounter__16BIT_COUNT_CONTROL_REG, CYREG_B0_UDB04_05_CTL
.set APPS_ADC_bSAR_SEQ_ChannelCounter__16BIT_COUNT_COUNT_REG, CYREG_B0_UDB04_05_CTL
.set APPS_ADC_bSAR_SEQ_ChannelCounter__16BIT_MASK_MASK_REG, CYREG_B0_UDB04_05_MSK
.set APPS_ADC_bSAR_SEQ_ChannelCounter__16BIT_MASK_PERIOD_REG, CYREG_B0_UDB04_05_MSK
.set APPS_ADC_bSAR_SEQ_ChannelCounter__16BIT_PERIOD_MASK_REG, CYREG_B0_UDB04_05_MSK
.set APPS_ADC_bSAR_SEQ_ChannelCounter__16BIT_PERIOD_PERIOD_REG, CYREG_B0_UDB04_05_MSK
.set APPS_ADC_bSAR_SEQ_ChannelCounter__CONTROL_AUX_CTL_REG, CYREG_B0_UDB04_ACTL
.set APPS_ADC_bSAR_SEQ_ChannelCounter__CONTROL_REG, CYREG_B0_UDB04_CTL
.set APPS_ADC_bSAR_SEQ_ChannelCounter__CONTROL_ST_REG, CYREG_B0_UDB04_ST_CTL
.set APPS_ADC_bSAR_SEQ_ChannelCounter__COUNT_REG, CYREG_B0_UDB04_CTL
.set APPS_ADC_bSAR_SEQ_ChannelCounter__COUNT_ST_REG, CYREG_B0_UDB04_ST_CTL
.set APPS_ADC_bSAR_SEQ_ChannelCounter__MASK_CTL_AUX_CTL_REG, CYREG_B0_UDB04_MSK_ACTL
.set APPS_ADC_bSAR_SEQ_ChannelCounter__PER_CTL_AUX_CTL_REG, CYREG_B0_UDB04_MSK_ACTL
.set APPS_ADC_bSAR_SEQ_ChannelCounter__PERIOD_REG, CYREG_B0_UDB04_MSK
.set APPS_ADC_bSAR_SEQ_ChannelCounter_ST__16BIT_STATUS_AUX_CTL_REG, CYREG_B0_UDB04_05_ACTL
.set APPS_ADC_bSAR_SEQ_ChannelCounter_ST__16BIT_STATUS_REG, CYREG_B0_UDB04_05_ST
.set APPS_ADC_bSAR_SEQ_ChannelCounter_ST__MASK_REG, CYREG_B0_UDB04_MSK
.set APPS_ADC_bSAR_SEQ_ChannelCounter_ST__MASK_ST_AUX_CTL_REG, CYREG_B0_UDB04_MSK_ACTL
.set APPS_ADC_bSAR_SEQ_ChannelCounter_ST__PER_ST_AUX_CTL_REG, CYREG_B0_UDB04_MSK_ACTL
.set APPS_ADC_bSAR_SEQ_ChannelCounter_ST__STATUS_AUX_CTL_REG, CYREG_B0_UDB04_ACTL
.set APPS_ADC_bSAR_SEQ_ChannelCounter_ST__STATUS_CNT_REG, CYREG_B0_UDB04_ST_CTL
.set APPS_ADC_bSAR_SEQ_ChannelCounter_ST__STATUS_CONTROL_REG, CYREG_B0_UDB04_ST_CTL
.set APPS_ADC_bSAR_SEQ_ChannelCounter_ST__STATUS_REG, CYREG_B0_UDB04_ST
.set APPS_ADC_bSAR_SEQ_CtrlReg__0__MASK, 0x01
.set APPS_ADC_bSAR_SEQ_CtrlReg__0__POS, 0
.set APPS_ADC_bSAR_SEQ_CtrlReg__1__MASK, 0x02
.set APPS_ADC_bSAR_SEQ_CtrlReg__1__POS, 1
.set APPS_ADC_bSAR_SEQ_CtrlReg__16BIT_CONTROL_AUX_CTL_REG, CYREG_B0_UDB07_08_ACTL
.set APPS_ADC_bSAR_SEQ_CtrlReg__16BIT_CONTROL_CONTROL_REG, CYREG_B0_UDB07_08_CTL
.set APPS_ADC_bSAR_SEQ_CtrlReg__16BIT_CONTROL_COUNT_REG, CYREG_B0_UDB07_08_CTL
.set APPS_ADC_bSAR_SEQ_CtrlReg__16BIT_COUNT_CONTROL_REG, CYREG_B0_UDB07_08_CTL
.set APPS_ADC_bSAR_SEQ_CtrlReg__16BIT_COUNT_COUNT_REG, CYREG_B0_UDB07_08_CTL
.set APPS_ADC_bSAR_SEQ_CtrlReg__16BIT_MASK_MASK_REG, CYREG_B0_UDB07_08_MSK
.set APPS_ADC_bSAR_SEQ_CtrlReg__16BIT_MASK_PERIOD_REG, CYREG_B0_UDB07_08_MSK
.set APPS_ADC_bSAR_SEQ_CtrlReg__16BIT_PERIOD_MASK_REG, CYREG_B0_UDB07_08_MSK
.set APPS_ADC_bSAR_SEQ_CtrlReg__16BIT_PERIOD_PERIOD_REG, CYREG_B0_UDB07_08_MSK
.set APPS_ADC_bSAR_SEQ_CtrlReg__2__MASK, 0x04
.set APPS_ADC_bSAR_SEQ_CtrlReg__2__POS, 2
.set APPS_ADC_bSAR_SEQ_CtrlReg__CONTROL_AUX_CTL_REG, CYREG_B0_UDB07_ACTL
.set APPS_ADC_bSAR_SEQ_CtrlReg__CONTROL_REG, CYREG_B0_UDB07_CTL
.set APPS_ADC_bSAR_SEQ_CtrlReg__CONTROL_ST_REG, CYREG_B0_UDB07_ST_CTL
.set APPS_ADC_bSAR_SEQ_CtrlReg__COUNT_REG, CYREG_B0_UDB07_CTL
.set APPS_ADC_bSAR_SEQ_CtrlReg__COUNT_ST_REG, CYREG_B0_UDB07_ST_CTL
.set APPS_ADC_bSAR_SEQ_CtrlReg__MASK, 0x07
.set APPS_ADC_bSAR_SEQ_CtrlReg__MASK_CTL_AUX_CTL_REG, CYREG_B0_UDB07_MSK_ACTL
.set APPS_ADC_bSAR_SEQ_CtrlReg__PER_CTL_AUX_CTL_REG, CYREG_B0_UDB07_MSK_ACTL
.set APPS_ADC_bSAR_SEQ_CtrlReg__PERIOD_REG, CYREG_B0_UDB07_MSK
.set APPS_ADC_bSAR_SEQ_EOCSts__0__MASK, 0x01
.set APPS_ADC_bSAR_SEQ_EOCSts__0__POS, 0
.set APPS_ADC_bSAR_SEQ_EOCSts__16BIT_STATUS_AUX_CTL_REG, CYREG_B1_UDB07_08_ACTL
.set APPS_ADC_bSAR_SEQ_EOCSts__16BIT_STATUS_REG, CYREG_B1_UDB07_08_ST
.set APPS_ADC_bSAR_SEQ_EOCSts__MASK, 0x01
.set APPS_ADC_bSAR_SEQ_EOCSts__MASK_REG, CYREG_B1_UDB07_MSK
.set APPS_ADC_bSAR_SEQ_EOCSts__STATUS_AUX_CTL_REG, CYREG_B1_UDB07_ACTL
.set APPS_ADC_bSAR_SEQ_EOCSts__STATUS_REG, CYREG_B1_UDB07_ST

/* APPS_ADC_FinalBuf */
.set APPS_ADC_FinalBuf__DRQ_CTL, CYREG_IDMUX_DRQ_CTL0
.set APPS_ADC_FinalBuf__DRQ_NUMBER, 0
.set APPS_ADC_FinalBuf__NUMBEROF_TDS, 0
.set APPS_ADC_FinalBuf__PRIORITY, 2
.set APPS_ADC_FinalBuf__TERMIN_EN, 0
.set APPS_ADC_FinalBuf__TERMIN_SEL, 0
.set APPS_ADC_FinalBuf__TERMOUT0_EN, 1
.set APPS_ADC_FinalBuf__TERMOUT0_SEL, 0
.set APPS_ADC_FinalBuf__TERMOUT1_EN, 0
.set APPS_ADC_FinalBuf__TERMOUT1_SEL, 0

/* APPS_ADC_IntClock */
.set APPS_ADC_IntClock__CFG0, CYREG_CLKDIST_DCFG3_CFG0
.set APPS_ADC_IntClock__CFG1, CYREG_CLKDIST_DCFG3_CFG1
.set APPS_ADC_IntClock__CFG2, CYREG_CLKDIST_DCFG3_CFG2
.set APPS_ADC_IntClock__CFG2_SRC_SEL_MASK, 0x07
.set APPS_ADC_IntClock__INDEX, 0x03
.set APPS_ADC_IntClock__PM_ACT_CFG, CYREG_PM_ACT_CFG2
.set APPS_ADC_IntClock__PM_ACT_MSK, 0x08
.set APPS_ADC_IntClock__PM_STBY_CFG, CYREG_PM_STBY_CFG2
.set APPS_ADC_IntClock__PM_STBY_MSK, 0x08

/* APPS_ADC_IRQ */
.set APPS_ADC_IRQ__INTC_CLR_EN_REG, CYREG_NVIC_CLRENA0
.set APPS_ADC_IRQ__INTC_CLR_PD_REG, CYREG_NVIC_CLRPEND0
.set APPS_ADC_IRQ__INTC_MASK, 0x01
.set APPS_ADC_IRQ__INTC_NUMBER, 0
.set APPS_ADC_IRQ__INTC_PRIOR_NUM, 7
.set APPS_ADC_IRQ__INTC_PRIOR_REG, CYREG_NVIC_PRI_0
.set APPS_ADC_IRQ__INTC_SET_EN_REG, CYREG_NVIC_SETENA0
.set APPS_ADC_IRQ__INTC_SET_PD_REG, CYREG_NVIC_SETPEND0

/* APPS_ADC_SAR_ADC_SAR */
.set APPS_ADC_SAR_ADC_SAR__CLK, CYREG_SAR1_CLK
.set APPS_ADC_SAR_ADC_SAR__CSR0, CYREG_SAR1_CSR0
.set APPS_ADC_SAR_ADC_SAR__CSR1, CYREG_SAR1_CSR1
.set APPS_ADC_SAR_ADC_SAR__CSR2, CYREG_SAR1_CSR2
.set APPS_ADC_SAR_ADC_SAR__CSR3, CYREG_SAR1_CSR3
.set APPS_ADC_SAR_ADC_SAR__CSR4, CYREG_SAR1_CSR4
.set APPS_ADC_SAR_ADC_SAR__CSR5, CYREG_SAR1_CSR5
.set APPS_ADC_SAR_ADC_SAR__CSR6, CYREG_SAR1_CSR6
.set APPS_ADC_SAR_ADC_SAR__PM_ACT_CFG, CYREG_PM_ACT_CFG11
.set APPS_ADC_SAR_ADC_SAR__PM_ACT_MSK, 0x02
.set APPS_ADC_SAR_ADC_SAR__PM_STBY_CFG, CYREG_PM_STBY_CFG11
.set APPS_ADC_SAR_ADC_SAR__PM_STBY_MSK, 0x02
.set APPS_ADC_SAR_ADC_SAR__SW0, CYREG_SAR1_SW0
.set APPS_ADC_SAR_ADC_SAR__SW2, CYREG_SAR1_SW2
.set APPS_ADC_SAR_ADC_SAR__SW3, CYREG_SAR1_SW3
.set APPS_ADC_SAR_ADC_SAR__SW4, CYREG_SAR1_SW4
.set APPS_ADC_SAR_ADC_SAR__SW6, CYREG_SAR1_SW6
.set APPS_ADC_SAR_ADC_SAR__TR0, CYREG_SAR1_TR0
.set APPS_ADC_SAR_ADC_SAR__WRK0, CYREG_SAR1_WRK0
.set APPS_ADC_SAR_ADC_SAR__WRK1, CYREG_SAR1_WRK1

/* APPS_ADC_TempBuf */
.set APPS_ADC_TempBuf__DRQ_CTL, CYREG_IDMUX_DRQ_CTL0
.set APPS_ADC_TempBuf__DRQ_NUMBER, 1
.set APPS_ADC_TempBuf__NUMBEROF_TDS, 0
.set APPS_ADC_TempBuf__PRIORITY, 2
.set APPS_ADC_TempBuf__TERMIN_EN, 0
.set APPS_ADC_TempBuf__TERMIN_SEL, 0
.set APPS_ADC_TempBuf__TERMOUT0_EN, 1
.set APPS_ADC_TempBuf__TERMOUT0_SEL, 1
.set APPS_ADC_TempBuf__TERMOUT1_EN, 0
.set APPS_ADC_TempBuf__TERMOUT1_SEL, 0

/* BRAKE_ADC_DEC */
.set BRAKE_ADC_DEC__COHER, CYREG_DEC_COHER
.set BRAKE_ADC_DEC__CR, CYREG_DEC_CR
.set BRAKE_ADC_DEC__DR1, CYREG_DEC_DR1
.set BRAKE_ADC_DEC__DR2, CYREG_DEC_DR2
.set BRAKE_ADC_DEC__DR2H, CYREG_DEC_DR2H
.set BRAKE_ADC_DEC__GCOR, CYREG_DEC_GCOR
.set BRAKE_ADC_DEC__GCORH, CYREG_DEC_GCORH
.set BRAKE_ADC_DEC__GVAL, CYREG_DEC_GVAL
.set BRAKE_ADC_DEC__OCOR, CYREG_DEC_OCOR
.set BRAKE_ADC_DEC__OCORH, CYREG_DEC_OCORH
.set BRAKE_ADC_DEC__OCORM, CYREG_DEC_OCORM
.set BRAKE_ADC_DEC__OUTSAMP, CYREG_DEC_OUTSAMP
.set BRAKE_ADC_DEC__OUTSAMPH, CYREG_DEC_OUTSAMPH
.set BRAKE_ADC_DEC__OUTSAMPM, CYREG_DEC_OUTSAMPM
.set BRAKE_ADC_DEC__OUTSAMPS, CYREG_DEC_OUTSAMPS
.set BRAKE_ADC_DEC__PM_ACT_CFG, CYREG_PM_ACT_CFG10
.set BRAKE_ADC_DEC__PM_ACT_MSK, 0x01
.set BRAKE_ADC_DEC__PM_STBY_CFG, CYREG_PM_STBY_CFG10
.set BRAKE_ADC_DEC__PM_STBY_MSK, 0x01
.set BRAKE_ADC_DEC__SHIFT1, CYREG_DEC_SHIFT1
.set BRAKE_ADC_DEC__SHIFT2, CYREG_DEC_SHIFT2
.set BRAKE_ADC_DEC__SR, CYREG_DEC_SR
.set BRAKE_ADC_DEC__TRIM__M1, CYREG_FLSHID_CUST_TABLES_DEC_M1
.set BRAKE_ADC_DEC__TRIM__M2, CYREG_FLSHID_CUST_TABLES_DEC_M2
.set BRAKE_ADC_DEC__TRIM__M3, CYREG_FLSHID_CUST_TABLES_DEC_M3
.set BRAKE_ADC_DEC__TRIM__M4, CYREG_FLSHID_CUST_TABLES_DEC_M4
.set BRAKE_ADC_DEC__TRIM__M5, CYREG_FLSHID_CUST_TABLES_DEC_M5
.set BRAKE_ADC_DEC__TRIM__M6, CYREG_FLSHID_CUST_TABLES_DEC_M6
.set BRAKE_ADC_DEC__TRIM__M7, CYREG_FLSHID_CUST_TABLES_DEC_M7
.set BRAKE_ADC_DEC__TRIM__M8, CYREG_FLSHID_CUST_TABLES_DEC_M8

/* BRAKE_ADC_DSM */
.set BRAKE_ADC_DSM__BUF0, CYREG_DSM0_BUF0
.set BRAKE_ADC_DSM__BUF1, CYREG_DSM0_BUF1
.set BRAKE_ADC_DSM__BUF2, CYREG_DSM0_BUF2
.set BRAKE_ADC_DSM__BUF3, CYREG_DSM0_BUF3
.set BRAKE_ADC_DSM__CLK, CYREG_DSM0_CLK
.set BRAKE_ADC_DSM__CR0, CYREG_DSM0_CR0
.set BRAKE_ADC_DSM__CR1, CYREG_DSM0_CR1
.set BRAKE_ADC_DSM__CR10, CYREG_DSM0_CR10
.set BRAKE_ADC_DSM__CR11, CYREG_DSM0_CR11
.set BRAKE_ADC_DSM__CR12, CYREG_DSM0_CR12
.set BRAKE_ADC_DSM__CR13, CYREG_DSM0_CR13
.set BRAKE_ADC_DSM__CR14, CYREG_DSM0_CR14
.set BRAKE_ADC_DSM__CR15, CYREG_DSM0_CR15
.set BRAKE_ADC_DSM__CR16, CYREG_DSM0_CR16
.set BRAKE_ADC_DSM__CR17, CYREG_DSM0_CR17
.set BRAKE_ADC_DSM__CR2, CYREG_DSM0_CR2
.set BRAKE_ADC_DSM__CR3, CYREG_DSM0_CR3
.set BRAKE_ADC_DSM__CR4, CYREG_DSM0_CR4
.set BRAKE_ADC_DSM__CR5, CYREG_DSM0_CR5
.set BRAKE_ADC_DSM__CR6, CYREG_DSM0_CR6
.set BRAKE_ADC_DSM__CR7, CYREG_DSM0_CR7
.set BRAKE_ADC_DSM__CR8, CYREG_DSM0_CR8
.set BRAKE_ADC_DSM__CR9, CYREG_DSM0_CR9
.set BRAKE_ADC_DSM__DEM0, CYREG_DSM0_DEM0
.set BRAKE_ADC_DSM__DEM1, CYREG_DSM0_DEM1
.set BRAKE_ADC_DSM__MISC, CYREG_DSM0_MISC
.set BRAKE_ADC_DSM__OUT0, CYREG_DSM0_OUT0
.set BRAKE_ADC_DSM__OUT1, CYREG_DSM0_OUT1
.set BRAKE_ADC_DSM__REF0, CYREG_DSM0_REF0
.set BRAKE_ADC_DSM__REF1, CYREG_DSM0_REF1
.set BRAKE_ADC_DSM__REF2, CYREG_DSM0_REF2
.set BRAKE_ADC_DSM__REF3, CYREG_DSM0_REF3
.set BRAKE_ADC_DSM__RSVD1, CYREG_DSM0_RSVD1
.set BRAKE_ADC_DSM__SW0, CYREG_DSM0_SW0
.set BRAKE_ADC_DSM__SW2, CYREG_DSM0_SW2
.set BRAKE_ADC_DSM__SW3, CYREG_DSM0_SW3
.set BRAKE_ADC_DSM__SW4, CYREG_DSM0_SW4
.set BRAKE_ADC_DSM__SW6, CYREG_DSM0_SW6
.set BRAKE_ADC_DSM__TR0, CYREG_NPUMP_DSM_TR0
.set BRAKE_ADC_DSM__TST0, CYREG_DSM0_TST0
.set BRAKE_ADC_DSM__TST1, CYREG_DSM0_TST1

/* BRAKE_ADC_Ext_CP_Clk */
.set BRAKE_ADC_Ext_CP_Clk__CFG0, CYREG_CLKDIST_DCFG0_CFG0
.set BRAKE_ADC_Ext_CP_Clk__CFG1, CYREG_CLKDIST_DCFG0_CFG1
.set BRAKE_ADC_Ext_CP_Clk__CFG2, CYREG_CLKDIST_DCFG0_CFG2
.set BRAKE_ADC_Ext_CP_Clk__CFG2_SRC_SEL_MASK, 0x07
.set BRAKE_ADC_Ext_CP_Clk__INDEX, 0x00
.set BRAKE_ADC_Ext_CP_Clk__PM_ACT_CFG, CYREG_PM_ACT_CFG2
.set BRAKE_ADC_Ext_CP_Clk__PM_ACT_MSK, 0x01
.set BRAKE_ADC_Ext_CP_Clk__PM_STBY_CFG, CYREG_PM_STBY_CFG2
.set BRAKE_ADC_Ext_CP_Clk__PM_STBY_MSK, 0x01

/* BRAKE_ADC_IRQ */
.set BRAKE_ADC_IRQ__INTC_CLR_EN_REG, CYREG_NVIC_CLRENA0
.set BRAKE_ADC_IRQ__INTC_CLR_PD_REG, CYREG_NVIC_CLRPEND0
.set BRAKE_ADC_IRQ__INTC_MASK, 0x20000000
.set BRAKE_ADC_IRQ__INTC_NUMBER, 29
.set BRAKE_ADC_IRQ__INTC_PRIOR_NUM, 7
.set BRAKE_ADC_IRQ__INTC_PRIOR_REG, CYREG_NVIC_PRI_29
.set BRAKE_ADC_IRQ__INTC_SET_EN_REG, CYREG_NVIC_SETENA0
.set BRAKE_ADC_IRQ__INTC_SET_PD_REG, CYREG_NVIC_SETPEND0

/* BRAKE_ADC_theACLK */
.set BRAKE_ADC_theACLK__CFG0, CYREG_CLKDIST_ACFG0_CFG0
.set BRAKE_ADC_theACLK__CFG1, CYREG_CLKDIST_ACFG0_CFG1
.set BRAKE_ADC_theACLK__CFG2, CYREG_CLKDIST_ACFG0_CFG2
.set BRAKE_ADC_theACLK__CFG2_SRC_SEL_MASK, 0x07
.set BRAKE_ADC_theACLK__CFG3, CYREG_CLKDIST_ACFG0_CFG3
.set BRAKE_ADC_theACLK__CFG3_PHASE_DLY_MASK, 0x0F
.set BRAKE_ADC_theACLK__INDEX, 0x00
.set BRAKE_ADC_theACLK__PM_ACT_CFG, CYREG_PM_ACT_CFG1
.set BRAKE_ADC_theACLK__PM_ACT_MSK, 0x01
.set BRAKE_ADC_theACLK__PM_STBY_CFG, CYREG_PM_STBY_CFG1
.set BRAKE_ADC_theACLK__PM_STBY_MSK, 0x01

/* SERVO_OUT */
.set SERVO_OUT__0__MASK, 0x01
.set SERVO_OUT__0__PC, CYREG_PRT0_PC0
.set SERVO_OUT__0__PORT, 0
.set SERVO_OUT__0__SHIFT, 0
.set SERVO_OUT__AG, CYREG_PRT0_AG
.set SERVO_OUT__AMUX, CYREG_PRT0_AMUX
.set SERVO_OUT__BIE, CYREG_PRT0_BIE
.set SERVO_OUT__BIT_MASK, CYREG_PRT0_BIT_MASK
.set SERVO_OUT__BYP, CYREG_PRT0_BYP
.set SERVO_OUT__CTL, CYREG_PRT0_CTL
.set SERVO_OUT__DM0, CYREG_PRT0_DM0
.set SERVO_OUT__DM1, CYREG_PRT0_DM1
.set SERVO_OUT__DM2, CYREG_PRT0_DM2
.set SERVO_OUT__DR, CYREG_PRT0_DR
.set SERVO_OUT__INP_DIS, CYREG_PRT0_INP_DIS
.set SERVO_OUT__LCD_COM_SEG, CYREG_PRT0_LCD_COM_SEG
.set SERVO_OUT__LCD_EN, CYREG_PRT0_LCD_EN
.set SERVO_OUT__MASK, 0x01
.set SERVO_OUT__PORT, 0
.set SERVO_OUT__PRT, CYREG_PRT0_PRT
.set SERVO_OUT__PRTDSI__CAPS_SEL, CYREG_PRT0_CAPS_SEL
.set SERVO_OUT__PRTDSI__DBL_SYNC_IN, CYREG_PRT0_DBL_SYNC_IN
.set SERVO_OUT__PRTDSI__OE_SEL0, CYREG_PRT0_OE_SEL0
.set SERVO_OUT__PRTDSI__OE_SEL1, CYREG_PRT0_OE_SEL1
.set SERVO_OUT__PRTDSI__OUT_SEL0, CYREG_PRT0_OUT_SEL0
.set SERVO_OUT__PRTDSI__OUT_SEL1, CYREG_PRT0_OUT_SEL1
.set SERVO_OUT__PRTDSI__SYNC_OUT, CYREG_PRT0_SYNC_OUT
.set SERVO_OUT__PS, CYREG_PRT0_PS
.set SERVO_OUT__SHIFT, 0
.set SERVO_OUT__SLW, CYREG_PRT0_SLW

/* SERVO_PWM_PWMUDB */
.set SERVO_PWM_PWMUDB_genblk1_ctrlreg__16BIT_CONTROL_AUX_CTL_REG, CYREG_B1_UDB04_05_ACTL
.set SERVO_PWM_PWMUDB_genblk1_ctrlreg__16BIT_CONTROL_CONTROL_REG, CYREG_B1_UDB04_05_CTL
.set SERVO_PWM_PWMUDB_genblk1_ctrlreg__16BIT_CONTROL_COUNT_REG, CYREG_B1_UDB04_05_CTL
.set SERVO_PWM_PWMUDB_genblk1_ctrlreg__16BIT_COUNT_CONTROL_REG, CYREG_B1_UDB04_05_CTL
.set SERVO_PWM_PWMUDB_genblk1_ctrlreg__16BIT_COUNT_COUNT_REG, CYREG_B1_UDB04_05_CTL
.set SERVO_PWM_PWMUDB_genblk1_ctrlreg__16BIT_MASK_MASK_REG, CYREG_B1_UDB04_05_MSK
.set SERVO_PWM_PWMUDB_genblk1_ctrlreg__16BIT_MASK_PERIOD_REG, CYREG_B1_UDB04_05_MSK
.set SERVO_PWM_PWMUDB_genblk1_ctrlreg__16BIT_PERIOD_MASK_REG, CYREG_B1_UDB04_05_MSK
.set SERVO_PWM_PWMUDB_genblk1_ctrlreg__16BIT_PERIOD_PERIOD_REG, CYREG_B1_UDB04_05_MSK
.set SERVO_PWM_PWMUDB_genblk1_ctrlreg__7__MASK, 0x80
.set SERVO_PWM_PWMUDB_genblk1_ctrlreg__7__POS, 7
.set SERVO_PWM_PWMUDB_genblk1_ctrlreg__CONTROL_AUX_CTL_REG, CYREG_B1_UDB04_ACTL
.set SERVO_PWM_PWMUDB_genblk1_ctrlreg__CONTROL_REG, CYREG_B1_UDB04_CTL
.set SERVO_PWM_PWMUDB_genblk1_ctrlreg__CONTROL_ST_REG, CYREG_B1_UDB04_ST_CTL
.set SERVO_PWM_PWMUDB_genblk1_ctrlreg__COUNT_REG, CYREG_B1_UDB04_CTL
.set SERVO_PWM_PWMUDB_genblk1_ctrlreg__COUNT_ST_REG, CYREG_B1_UDB04_ST_CTL
.set SERVO_PWM_PWMUDB_genblk1_ctrlreg__MASK, 0x80
.set SERVO_PWM_PWMUDB_genblk1_ctrlreg__MASK_CTL_AUX_CTL_REG, CYREG_B1_UDB04_MSK_ACTL
.set SERVO_PWM_PWMUDB_genblk1_ctrlreg__PER_CTL_AUX_CTL_REG, CYREG_B1_UDB04_MSK_ACTL
.set SERVO_PWM_PWMUDB_genblk1_ctrlreg__PERIOD_REG, CYREG_B1_UDB04_MSK
.set SERVO_PWM_PWMUDB_genblk8_stsreg__0__MASK, 0x01
.set SERVO_PWM_PWMUDB_genblk8_stsreg__0__POS, 0
.set SERVO_PWM_PWMUDB_genblk8_stsreg__1__MASK, 0x02
.set SERVO_PWM_PWMUDB_genblk8_stsreg__1__POS, 1
.set SERVO_PWM_PWMUDB_genblk8_stsreg__16BIT_STATUS_AUX_CTL_REG, CYREG_B1_UDB04_05_ACTL
.set SERVO_PWM_PWMUDB_genblk8_stsreg__16BIT_STATUS_REG, CYREG_B1_UDB04_05_ST
.set SERVO_PWM_PWMUDB_genblk8_stsreg__2__MASK, 0x04
.set SERVO_PWM_PWMUDB_genblk8_stsreg__2__POS, 2
.set SERVO_PWM_PWMUDB_genblk8_stsreg__3__MASK, 0x08
.set SERVO_PWM_PWMUDB_genblk8_stsreg__3__POS, 3
.set SERVO_PWM_PWMUDB_genblk8_stsreg__MASK, 0x0F
.set SERVO_PWM_PWMUDB_genblk8_stsreg__MASK_REG, CYREG_B1_UDB04_MSK
.set SERVO_PWM_PWMUDB_genblk8_stsreg__MASK_ST_AUX_CTL_REG, CYREG_B1_UDB04_MSK_ACTL
.set SERVO_PWM_PWMUDB_genblk8_stsreg__PER_ST_AUX_CTL_REG, CYREG_B1_UDB04_MSK_ACTL
.set SERVO_PWM_PWMUDB_genblk8_stsreg__STATUS_AUX_CTL_REG, CYREG_B1_UDB04_ACTL
.set SERVO_PWM_PWMUDB_genblk8_stsreg__STATUS_CNT_REG, CYREG_B1_UDB04_ST_CTL
.set SERVO_PWM_PWMUDB_genblk8_stsreg__STATUS_CONTROL_REG, CYREG_B1_UDB04_ST_CTL
.set SERVO_PWM_PWMUDB_genblk8_stsreg__STATUS_REG, CYREG_B1_UDB04_ST
.set SERVO_PWM_PWMUDB_sP8_pwmdp_u0__16BIT_A0_REG, CYREG_B1_UDB04_05_A0
.set SERVO_PWM_PWMUDB_sP8_pwmdp_u0__16BIT_A1_REG, CYREG_B1_UDB04_05_A1
.set SERVO_PWM_PWMUDB_sP8_pwmdp_u0__16BIT_D0_REG, CYREG_B1_UDB04_05_D0
.set SERVO_PWM_PWMUDB_sP8_pwmdp_u0__16BIT_D1_REG, CYREG_B1_UDB04_05_D1
.set SERVO_PWM_PWMUDB_sP8_pwmdp_u0__16BIT_DP_AUX_CTL_REG, CYREG_B1_UDB04_05_ACTL
.set SERVO_PWM_PWMUDB_sP8_pwmdp_u0__16BIT_F0_REG, CYREG_B1_UDB04_05_F0
.set SERVO_PWM_PWMUDB_sP8_pwmdp_u0__16BIT_F1_REG, CYREG_B1_UDB04_05_F1
.set SERVO_PWM_PWMUDB_sP8_pwmdp_u0__A0_A1_REG, CYREG_B1_UDB04_A0_A1
.set SERVO_PWM_PWMUDB_sP8_pwmdp_u0__A0_REG, CYREG_B1_UDB04_A0
.set SERVO_PWM_PWMUDB_sP8_pwmdp_u0__A1_REG, CYREG_B1_UDB04_A1
.set SERVO_PWM_PWMUDB_sP8_pwmdp_u0__D0_D1_REG, CYREG_B1_UDB04_D0_D1
.set SERVO_PWM_PWMUDB_sP8_pwmdp_u0__D0_REG, CYREG_B1_UDB04_D0
.set SERVO_PWM_PWMUDB_sP8_pwmdp_u0__D1_REG, CYREG_B1_UDB04_D1
.set SERVO_PWM_PWMUDB_sP8_pwmdp_u0__DP_AUX_CTL_REG, CYREG_B1_UDB04_ACTL
.set SERVO_PWM_PWMUDB_sP8_pwmdp_u0__F0_F1_REG, CYREG_B1_UDB04_F0_F1
.set SERVO_PWM_PWMUDB_sP8_pwmdp_u0__F0_REG, CYREG_B1_UDB04_F0
.set SERVO_PWM_PWMUDB_sP8_pwmdp_u0__F1_REG, CYREG_B1_UDB04_F1
.set SERVO_PWM_PWMUDB_sP8_pwmdp_u0__MSK_DP_AUX_CTL_REG, CYREG_B1_UDB04_MSK_ACTL
.set SERVO_PWM_PWMUDB_sP8_pwmdp_u0__PER_DP_AUX_CTL_REG, CYREG_B1_UDB04_MSK_ACTL

/* Miscellaneous */
.set BCLK__BUS_CLK__HZ, 24000000
.set BCLK__BUS_CLK__KHZ, 24000
.set BCLK__BUS_CLK__MHZ, 24
.set CYDEV_CHIP_DIE_GEN4, 2
.set CYDEV_CHIP_DIE_LEOPARD, 1
.set CYDEV_CHIP_DIE_PANTHER, 13
.set CYDEV_CHIP_DIE_PSOC4A, 6
.set CYDEV_CHIP_DIE_PSOC5LP, 12
.set CYDEV_CHIP_DIE_UNKNOWN, 0
.set CYDEV_CHIP_FAMILY_PSOC3, 1
.set CYDEV_CHIP_FAMILY_PSOC4, 2
.set CYDEV_CHIP_FAMILY_PSOC5, 3
.set CYDEV_CHIP_FAMILY_UNKNOWN, 0
.set CYDEV_CHIP_FAMILY_USED, CYDEV_CHIP_FAMILY_PSOC5
.set CYDEV_CHIP_JTAG_ID, 0x2E161069
.set CYDEV_CHIP_MEMBER_3A, 1
.set CYDEV_CHIP_MEMBER_4A, 6
.set CYDEV_CHIP_MEMBER_4C, 10
.set CYDEV_CHIP_MEMBER_4D, 3
.set CYDEV_CHIP_MEMBER_4E, 5
.set CYDEV_CHIP_MEMBER_4F, 7
.set CYDEV_CHIP_MEMBER_4G, 2
.set CYDEV_CHIP_MEMBER_4H, 4
.set CYDEV_CHIP_MEMBER_4L, 9
.set CYDEV_CHIP_MEMBER_4M, 8
.set CYDEV_CHIP_MEMBER_5A, 12
.set CYDEV_CHIP_MEMBER_5B, 11
.set CYDEV_CHIP_MEMBER_UNKNOWN, 0
.set CYDEV_CHIP_MEMBER_USED, CYDEV_CHIP_MEMBER_5B
.set CYDEV_CHIP_DIE_EXPECT, CYDEV_CHIP_MEMBER_USED
.set CYDEV_CHIP_DIE_ACTUAL, CYDEV_CHIP_DIE_EXPECT
.set CYDEV_CHIP_REV_GEN4_ES, 17
.set CYDEV_CHIP_REV_GEN4_ES2, 33
.set CYDEV_CHIP_REV_GEN4_PRODUCTION, 17
.set CYDEV_CHIP_REV_LEOPARD_ES1, 0
.set CYDEV_CHIP_REV_LEOPARD_ES2, 1
.set CYDEV_CHIP_REV_LEOPARD_ES3, 3
.set CYDEV_CHIP_REV_LEOPARD_PRODUCTION, 3
.set CYDEV_CHIP_REV_PANTHER_ES0, 0
.set CYDEV_CHIP_REV_PANTHER_ES1, 1
.set CYDEV_CHIP_REV_PANTHER_PRODUCTION, 1
.set CYDEV_CHIP_REV_PSOC4A_ES0, 17
.set CYDEV_CHIP_REV_PSOC4A_PRODUCTION, 17
.set CYDEV_CHIP_REV_PSOC5LP_ES0, 0
.set CYDEV_CHIP_REV_PSOC5LP_PRODUCTION, 0
.set CYDEV_CHIP_REVISION_3A_ES1, 0
.set CYDEV_CHIP_REVISION_3A_ES2, 1
.set CYDEV_CHIP_REVISION_3A_ES3, 3
.set CYDEV_CHIP_REVISION_3A_PRODUCTION, 3
.set CYDEV_CHIP_REVISION_4A_ES0, 17
.set CYDEV_CHIP_REVISION_4A_PRODUCTION, 17
.set CYDEV_CHIP_REVISION_4C_PRODUCTION, 0
.set CYDEV_CHIP_REVISION_4D_PRODUCTION, 0
.set CYDEV_CHIP_REVISION_4E_PRODUCTION, 0
.set CYDEV_CHIP_REVISION_4F_PRODUCTION, 0
.set CYDEV_CHIP_REVISION_4F_PRODUCTION_256K, 0
.set CYDEV_CHIP_REVISION_4G_ES, 17
.set CYDEV_CHIP_REVISION_4G_ES2, 33
.set CYDEV_CHIP_REVISION_4G_PRODUCTION, 17
.set CYDEV_CHIP_REVISION_4H_PRODUCTION, 0
.set CYDEV_CHIP_REVISION_4L_PRODUCTION, 0
.set CYDEV_CHIP_REVISION_4M_PRODUCTION, 0
.set CYDEV_CHIP_REVISION_5A_ES0, 0
.set CYDEV_CHIP_REVISION_5A_ES1, 1
.set CYDEV_CHIP_REVISION_5A_PRODUCTION, 1
.set CYDEV_CHIP_REVISION_5B_ES0, 0
.set CYDEV_CHIP_REVISION_5B_PRODUCTION, 0
.set CYDEV_CHIP_REVISION_USED, CYDEV_CHIP_REVISION_5B_PRODUCTION
.set CYDEV_CHIP_REV_EXPECT, CYDEV_CHIP_REVISION_USED
.set CYDEV_CONFIG_FASTBOOT_ENABLED, 1
.set CYDEV_CONFIG_UNUSED_IO_AllowButWarn, 0
.set CYDEV_CONFIG_UNUSED_IO, CYDEV_CONFIG_UNUSED_IO_AllowButWarn
.set CYDEV_CONFIG_UNUSED_IO_AllowWithInfo, 1
.set CYDEV_CONFIG_UNUSED_IO_Disallowed, 2
.set CYDEV_CONFIGURATION_COMPRESSED, 1
.set CYDEV_CONFIGURATION_DMA, 0
.set CYDEV_CONFIGURATION_ECC, 1
.set CYDEV_CONFIGURATION_IMOENABLED, CYDEV_CONFIG_FASTBOOT_ENABLED
.set CYDEV_CONFIGURATION_MODE_COMPRESSED, 0
.set CYDEV_CONFIGURATION_MODE, CYDEV_CONFIGURATION_MODE_COMPRESSED
.set CYDEV_CONFIGURATION_MODE_DMA, 2
.set CYDEV_CONFIGURATION_MODE_UNCOMPRESSED, 1
.set CYDEV_DEBUG_ENABLE_MASK, 0x20
.set CYDEV_DEBUG_ENABLE_REGISTER, CYREG_MLOGIC_DEBUG
.set CYDEV_DEBUGGING_DPS_Disable, 3
.set CYDEV_DEBUGGING_DPS_JTAG_4, 1
.set CYDEV_DEBUGGING_DPS_JTAG_5, 0
.set CYDEV_DEBUGGING_DPS_SWD, 2
.set CYDEV_DEBUGGING_DPS_SWD_SWV, 6
.set CYDEV_DEBUGGING_DPS, CYDEV_DEBUGGING_DPS_SWD_SWV
.set CYDEV_DEBUGGING_ENABLE, 1
.set CYDEV_DEBUGGING_XRES, 0
.set CYDEV_DMA_CHANNELS_AVAILABLE, 24
.set CYDEV_ECC_ENABLE, 0
.set CYDEV_HEAP_SIZE, 0x80
.set CYDEV_INSTRUCT_CACHE_ENABLED, 1
.set CYDEV_INTR_RISING, 0x00000003
.set CYDEV_PROJ_TYPE, 0
.set CYDEV_PROJ_TYPE_BOOTLOADER, 1
.set CYDEV_PROJ_TYPE_LAUNCHER, 5
.set CYDEV_PROJ_TYPE_LOADABLE, 2
.set CYDEV_PROJ_TYPE_LOADABLEANDBOOTLOADER, 4
.set CYDEV_PROJ_TYPE_MULTIAPPBOOTLOADER, 3
.set CYDEV_PROJ_TYPE_STANDARD, 0
.set CYDEV_PROTECTION_ENABLE, 0
.set CYDEV_STACK_SIZE, 0x0800
.set CYDEV_USE_BUNDLED_CMSIS, 1
.set CYDEV_VARIABLE_VDDA, 0
.set CYDEV_VDDA_MV, 5000
.set CYDEV_VDDD_MV, 5000
.set CYDEV_VDDIO0_MV, 5000
.set CYDEV_VDDIO1_MV, 5000
.set CYDEV_VDDIO2_MV, 5000
.set CYDEV_VDDIO3_MV, 5000
.set CYDEV_VIO0_MV, 5000
.set CYDEV_VIO1_MV, 5000
.set CYDEV_VIO2_MV, 5000
.set CYDEV_VIO3_MV, 5000
.set CYIPBLOCK_ARM_CM3_VERSION, 0
.set CYIPBLOCK_P3_ANAIF_VERSION, 0
.set CYIPBLOCK_P3_CAN_VERSION, 0
.set CYIPBLOCK_P3_CAPSENSE_VERSION, 0
.set CYIPBLOCK_P3_COMP_VERSION, 0
.set CYIPBLOCK_P3_DECIMATOR_VERSION, 0
.set CYIPBLOCK_P3_DFB_VERSION, 0
.set CYIPBLOCK_P3_DMA_VERSION, 0
.set CYIPBLOCK_P3_DRQ_VERSION, 0
.set CYIPBLOCK_P3_DSM_VERSION, 0
.set CYIPBLOCK_P3_EMIF_VERSION, 0
.set CYIPBLOCK_P3_I2C_VERSION, 0
.set CYIPBLOCK_P3_LCD_VERSION, 0
.set CYIPBLOCK_P3_LPF_VERSION, 0
.set CYIPBLOCK_P3_OPAMP_VERSION, 0
.set CYIPBLOCK_P3_PM_VERSION, 0
.set CYIPBLOCK_P3_SCCT_VERSION, 0
.set CYIPBLOCK_P3_TIMER_VERSION, 0
.set CYIPBLOCK_P3_USB_VERSION, 0
.set CYIPBLOCK_P3_VIDAC_VERSION, 0
.set CYIPBLOCK_P3_VREF_VERSION, 0
.set CYIPBLOCK_S8_GPIO_VERSION, 0
.set CYIPBLOCK_S8_IRQ_VERSION, 0
.set CYIPBLOCK_S8_SAR_VERSION, 0
.set CYIPBLOCK_S8_SIO_VERSION, 0
.set CYIPBLOCK_S8_UDB_VERSION, 0
.set DMA_CHANNELS_USED__MASK0, 0x0000000F
.set CYDEV_BOOTLOADER_ENABLE, 0
.endif
