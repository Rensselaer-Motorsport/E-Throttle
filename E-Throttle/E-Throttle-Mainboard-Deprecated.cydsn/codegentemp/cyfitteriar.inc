#ifndef INCLUDED_CYFITTERIAR_INC
#define INCLUDED_CYFITTERIAR_INC
    INCLUDE cydeviceiar.inc
    INCLUDE cydeviceiar_trm.inc

/* TPS_0 */
TPS_0__0__MASK EQU 0x08
TPS_0__0__PC EQU CYREG_PRT3_PC3
TPS_0__0__PORT EQU 3
TPS_0__0__SHIFT EQU 3
TPS_0__AG EQU CYREG_PRT3_AG
TPS_0__AMUX EQU CYREG_PRT3_AMUX
TPS_0__BIE EQU CYREG_PRT3_BIE
TPS_0__BIT_MASK EQU CYREG_PRT3_BIT_MASK
TPS_0__BYP EQU CYREG_PRT3_BYP
TPS_0__CTL EQU CYREG_PRT3_CTL
TPS_0__DM0 EQU CYREG_PRT3_DM0
TPS_0__DM1 EQU CYREG_PRT3_DM1
TPS_0__DM2 EQU CYREG_PRT3_DM2
TPS_0__DR EQU CYREG_PRT3_DR
TPS_0__INP_DIS EQU CYREG_PRT3_INP_DIS
TPS_0__LCD_COM_SEG EQU CYREG_PRT3_LCD_COM_SEG
TPS_0__LCD_EN EQU CYREG_PRT3_LCD_EN
TPS_0__MASK EQU 0x08
TPS_0__PORT EQU 3
TPS_0__PRT EQU CYREG_PRT3_PRT
TPS_0__PRTDSI__CAPS_SEL EQU CYREG_PRT3_CAPS_SEL
TPS_0__PRTDSI__DBL_SYNC_IN EQU CYREG_PRT3_DBL_SYNC_IN
TPS_0__PRTDSI__OE_SEL0 EQU CYREG_PRT3_OE_SEL0
TPS_0__PRTDSI__OE_SEL1 EQU CYREG_PRT3_OE_SEL1
TPS_0__PRTDSI__OUT_SEL0 EQU CYREG_PRT3_OUT_SEL0
TPS_0__PRTDSI__OUT_SEL1 EQU CYREG_PRT3_OUT_SEL1
TPS_0__PRTDSI__SYNC_OUT EQU CYREG_PRT3_SYNC_OUT
TPS_0__PS EQU CYREG_PRT3_PS
TPS_0__SHIFT EQU 3
TPS_0__SLW EQU CYREG_PRT3_SLW

/* TPS_1 */
TPS_1__0__MASK EQU 0x08
TPS_1__0__PC EQU CYREG_IO_PC_PRT15_PC3
TPS_1__0__PORT EQU 15
TPS_1__0__SHIFT EQU 3
TPS_1__AG EQU CYREG_PRT15_AG
TPS_1__AMUX EQU CYREG_PRT15_AMUX
TPS_1__BIE EQU CYREG_PRT15_BIE
TPS_1__BIT_MASK EQU CYREG_PRT15_BIT_MASK
TPS_1__BYP EQU CYREG_PRT15_BYP
TPS_1__CTL EQU CYREG_PRT15_CTL
TPS_1__DM0 EQU CYREG_PRT15_DM0
TPS_1__DM1 EQU CYREG_PRT15_DM1
TPS_1__DM2 EQU CYREG_PRT15_DM2
TPS_1__DR EQU CYREG_PRT15_DR
TPS_1__INP_DIS EQU CYREG_PRT15_INP_DIS
TPS_1__LCD_COM_SEG EQU CYREG_PRT15_LCD_COM_SEG
TPS_1__LCD_EN EQU CYREG_PRT15_LCD_EN
TPS_1__MASK EQU 0x08
TPS_1__PORT EQU 15
TPS_1__PRT EQU CYREG_PRT15_PRT
TPS_1__PRTDSI__CAPS_SEL EQU CYREG_PRT15_CAPS_SEL
TPS_1__PRTDSI__DBL_SYNC_IN EQU CYREG_PRT15_DBL_SYNC_IN
TPS_1__PRTDSI__OE_SEL0 EQU CYREG_PRT15_OE_SEL0
TPS_1__PRTDSI__OE_SEL1 EQU CYREG_PRT15_OE_SEL1
TPS_1__PRTDSI__OUT_SEL0 EQU CYREG_PRT15_OUT_SEL0
TPS_1__PRTDSI__OUT_SEL1 EQU CYREG_PRT15_OUT_SEL1
TPS_1__PRTDSI__SYNC_OUT EQU CYREG_PRT15_SYNC_OUT
TPS_1__PS EQU CYREG_PRT15_PS
TPS_1__SHIFT EQU 3
TPS_1__SLW EQU CYREG_PRT15_SLW

/* APPS_0 */
APPS_0__0__MASK EQU 0x80
APPS_0__0__PC EQU CYREG_PRT4_PC7
APPS_0__0__PORT EQU 4
APPS_0__0__SHIFT EQU 7
APPS_0__AG EQU CYREG_PRT4_AG
APPS_0__AMUX EQU CYREG_PRT4_AMUX
APPS_0__BIE EQU CYREG_PRT4_BIE
APPS_0__BIT_MASK EQU CYREG_PRT4_BIT_MASK
APPS_0__BYP EQU CYREG_PRT4_BYP
APPS_0__CTL EQU CYREG_PRT4_CTL
APPS_0__DM0 EQU CYREG_PRT4_DM0
APPS_0__DM1 EQU CYREG_PRT4_DM1
APPS_0__DM2 EQU CYREG_PRT4_DM2
APPS_0__DR EQU CYREG_PRT4_DR
APPS_0__INP_DIS EQU CYREG_PRT4_INP_DIS
APPS_0__LCD_COM_SEG EQU CYREG_PRT4_LCD_COM_SEG
APPS_0__LCD_EN EQU CYREG_PRT4_LCD_EN
APPS_0__MASK EQU 0x80
APPS_0__PORT EQU 4
APPS_0__PRT EQU CYREG_PRT4_PRT
APPS_0__PRTDSI__CAPS_SEL EQU CYREG_PRT4_CAPS_SEL
APPS_0__PRTDSI__DBL_SYNC_IN EQU CYREG_PRT4_DBL_SYNC_IN
APPS_0__PRTDSI__OE_SEL0 EQU CYREG_PRT4_OE_SEL0
APPS_0__PRTDSI__OE_SEL1 EQU CYREG_PRT4_OE_SEL1
APPS_0__PRTDSI__OUT_SEL0 EQU CYREG_PRT4_OUT_SEL0
APPS_0__PRTDSI__OUT_SEL1 EQU CYREG_PRT4_OUT_SEL1
APPS_0__PRTDSI__SYNC_OUT EQU CYREG_PRT4_SYNC_OUT
APPS_0__PS EQU CYREG_PRT4_PS
APPS_0__SHIFT EQU 7
APPS_0__SLW EQU CYREG_PRT4_SLW

/* APPS_1 */
APPS_1__0__MASK EQU 0x08
APPS_1__0__PC EQU CYREG_PRT0_PC3
APPS_1__0__PORT EQU 0
APPS_1__0__SHIFT EQU 3
APPS_1__AG EQU CYREG_PRT0_AG
APPS_1__AMUX EQU CYREG_PRT0_AMUX
APPS_1__BIE EQU CYREG_PRT0_BIE
APPS_1__BIT_MASK EQU CYREG_PRT0_BIT_MASK
APPS_1__BYP EQU CYREG_PRT0_BYP
APPS_1__CTL EQU CYREG_PRT0_CTL
APPS_1__DM0 EQU CYREG_PRT0_DM0
APPS_1__DM1 EQU CYREG_PRT0_DM1
APPS_1__DM2 EQU CYREG_PRT0_DM2
APPS_1__DR EQU CYREG_PRT0_DR
APPS_1__INP_DIS EQU CYREG_PRT0_INP_DIS
APPS_1__LCD_COM_SEG EQU CYREG_PRT0_LCD_COM_SEG
APPS_1__LCD_EN EQU CYREG_PRT0_LCD_EN
APPS_1__MASK EQU 0x08
APPS_1__PORT EQU 0
APPS_1__PRT EQU CYREG_PRT0_PRT
APPS_1__PRTDSI__CAPS_SEL EQU CYREG_PRT0_CAPS_SEL
APPS_1__PRTDSI__DBL_SYNC_IN EQU CYREG_PRT0_DBL_SYNC_IN
APPS_1__PRTDSI__OE_SEL0 EQU CYREG_PRT0_OE_SEL0
APPS_1__PRTDSI__OE_SEL1 EQU CYREG_PRT0_OE_SEL1
APPS_1__PRTDSI__OUT_SEL0 EQU CYREG_PRT0_OUT_SEL0
APPS_1__PRTDSI__OUT_SEL1 EQU CYREG_PRT0_OUT_SEL1
APPS_1__PRTDSI__SYNC_OUT EQU CYREG_PRT0_SYNC_OUT
APPS_1__PS EQU CYREG_PRT0_PS
APPS_1__SHIFT EQU 3
APPS_1__SLW EQU CYREG_PRT0_SLW

/* Clock_1 */
Clock_1__CFG0 EQU CYREG_CLKDIST_DCFG0_CFG0
Clock_1__CFG1 EQU CYREG_CLKDIST_DCFG0_CFG1
Clock_1__CFG2 EQU CYREG_CLKDIST_DCFG0_CFG2
Clock_1__CFG2_SRC_SEL_MASK EQU 0x07
Clock_1__INDEX EQU 0x00
Clock_1__PM_ACT_CFG EQU CYREG_PM_ACT_CFG2
Clock_1__PM_ACT_MSK EQU 0x01
Clock_1__PM_STBY_CFG EQU CYREG_PM_STBY_CFG2
Clock_1__PM_STBY_MSK EQU 0x01

/* TPS_ADC_bSAR_SEQ */
TPS_ADC_bSAR_SEQ_ChannelCounter__16BIT_CONTROL_AUX_CTL_REG EQU CYREG_B0_UDB05_06_ACTL
TPS_ADC_bSAR_SEQ_ChannelCounter__16BIT_CONTROL_CONTROL_REG EQU CYREG_B0_UDB05_06_CTL
TPS_ADC_bSAR_SEQ_ChannelCounter__16BIT_CONTROL_COUNT_REG EQU CYREG_B0_UDB05_06_CTL
TPS_ADC_bSAR_SEQ_ChannelCounter__16BIT_COUNT_CONTROL_REG EQU CYREG_B0_UDB05_06_CTL
TPS_ADC_bSAR_SEQ_ChannelCounter__16BIT_COUNT_COUNT_REG EQU CYREG_B0_UDB05_06_CTL
TPS_ADC_bSAR_SEQ_ChannelCounter__16BIT_MASK_MASK_REG EQU CYREG_B0_UDB05_06_MSK
TPS_ADC_bSAR_SEQ_ChannelCounter__16BIT_MASK_PERIOD_REG EQU CYREG_B0_UDB05_06_MSK
TPS_ADC_bSAR_SEQ_ChannelCounter__16BIT_PERIOD_MASK_REG EQU CYREG_B0_UDB05_06_MSK
TPS_ADC_bSAR_SEQ_ChannelCounter__16BIT_PERIOD_PERIOD_REG EQU CYREG_B0_UDB05_06_MSK
TPS_ADC_bSAR_SEQ_ChannelCounter__CONTROL_AUX_CTL_REG EQU CYREG_B0_UDB05_ACTL
TPS_ADC_bSAR_SEQ_ChannelCounter__CONTROL_REG EQU CYREG_B0_UDB05_CTL
TPS_ADC_bSAR_SEQ_ChannelCounter__CONTROL_ST_REG EQU CYREG_B0_UDB05_ST_CTL
TPS_ADC_bSAR_SEQ_ChannelCounter__COUNT_REG EQU CYREG_B0_UDB05_CTL
TPS_ADC_bSAR_SEQ_ChannelCounter__COUNT_ST_REG EQU CYREG_B0_UDB05_ST_CTL
TPS_ADC_bSAR_SEQ_ChannelCounter__MASK_CTL_AUX_CTL_REG EQU CYREG_B0_UDB05_MSK_ACTL
TPS_ADC_bSAR_SEQ_ChannelCounter__PER_CTL_AUX_CTL_REG EQU CYREG_B0_UDB05_MSK_ACTL
TPS_ADC_bSAR_SEQ_ChannelCounter__PERIOD_REG EQU CYREG_B0_UDB05_MSK
TPS_ADC_bSAR_SEQ_ChannelCounter_ST__16BIT_STATUS_AUX_CTL_REG EQU CYREG_B0_UDB05_06_ACTL
TPS_ADC_bSAR_SEQ_ChannelCounter_ST__16BIT_STATUS_REG EQU CYREG_B0_UDB05_06_ST
TPS_ADC_bSAR_SEQ_ChannelCounter_ST__MASK_REG EQU CYREG_B0_UDB05_MSK
TPS_ADC_bSAR_SEQ_ChannelCounter_ST__MASK_ST_AUX_CTL_REG EQU CYREG_B0_UDB05_MSK_ACTL
TPS_ADC_bSAR_SEQ_ChannelCounter_ST__PER_ST_AUX_CTL_REG EQU CYREG_B0_UDB05_MSK_ACTL
TPS_ADC_bSAR_SEQ_ChannelCounter_ST__STATUS_AUX_CTL_REG EQU CYREG_B0_UDB05_ACTL
TPS_ADC_bSAR_SEQ_ChannelCounter_ST__STATUS_CNT_REG EQU CYREG_B0_UDB05_ST_CTL
TPS_ADC_bSAR_SEQ_ChannelCounter_ST__STATUS_CONTROL_REG EQU CYREG_B0_UDB05_ST_CTL
TPS_ADC_bSAR_SEQ_ChannelCounter_ST__STATUS_REG EQU CYREG_B0_UDB05_ST
TPS_ADC_bSAR_SEQ_CtrlReg__0__MASK EQU 0x01
TPS_ADC_bSAR_SEQ_CtrlReg__0__POS EQU 0
TPS_ADC_bSAR_SEQ_CtrlReg__1__MASK EQU 0x02
TPS_ADC_bSAR_SEQ_CtrlReg__1__POS EQU 1
TPS_ADC_bSAR_SEQ_CtrlReg__16BIT_CONTROL_AUX_CTL_REG EQU CYREG_B0_UDB03_04_ACTL
TPS_ADC_bSAR_SEQ_CtrlReg__16BIT_CONTROL_CONTROL_REG EQU CYREG_B0_UDB03_04_CTL
TPS_ADC_bSAR_SEQ_CtrlReg__16BIT_CONTROL_COUNT_REG EQU CYREG_B0_UDB03_04_CTL
TPS_ADC_bSAR_SEQ_CtrlReg__16BIT_COUNT_CONTROL_REG EQU CYREG_B0_UDB03_04_CTL
TPS_ADC_bSAR_SEQ_CtrlReg__16BIT_COUNT_COUNT_REG EQU CYREG_B0_UDB03_04_CTL
TPS_ADC_bSAR_SEQ_CtrlReg__16BIT_MASK_MASK_REG EQU CYREG_B0_UDB03_04_MSK
TPS_ADC_bSAR_SEQ_CtrlReg__16BIT_MASK_PERIOD_REG EQU CYREG_B0_UDB03_04_MSK
TPS_ADC_bSAR_SEQ_CtrlReg__16BIT_PERIOD_MASK_REG EQU CYREG_B0_UDB03_04_MSK
TPS_ADC_bSAR_SEQ_CtrlReg__16BIT_PERIOD_PERIOD_REG EQU CYREG_B0_UDB03_04_MSK
TPS_ADC_bSAR_SEQ_CtrlReg__CONTROL_AUX_CTL_REG EQU CYREG_B0_UDB03_ACTL
TPS_ADC_bSAR_SEQ_CtrlReg__CONTROL_REG EQU CYREG_B0_UDB03_CTL
TPS_ADC_bSAR_SEQ_CtrlReg__CONTROL_ST_REG EQU CYREG_B0_UDB03_ST_CTL
TPS_ADC_bSAR_SEQ_CtrlReg__COUNT_REG EQU CYREG_B0_UDB03_CTL
TPS_ADC_bSAR_SEQ_CtrlReg__COUNT_ST_REG EQU CYREG_B0_UDB03_ST_CTL
TPS_ADC_bSAR_SEQ_CtrlReg__MASK EQU 0x03
TPS_ADC_bSAR_SEQ_CtrlReg__MASK_CTL_AUX_CTL_REG EQU CYREG_B0_UDB03_MSK_ACTL
TPS_ADC_bSAR_SEQ_CtrlReg__PER_CTL_AUX_CTL_REG EQU CYREG_B0_UDB03_MSK_ACTL
TPS_ADC_bSAR_SEQ_CtrlReg__PERIOD_REG EQU CYREG_B0_UDB03_MSK
TPS_ADC_bSAR_SEQ_EOCSts__0__MASK EQU 0x01
TPS_ADC_bSAR_SEQ_EOCSts__0__POS EQU 0
TPS_ADC_bSAR_SEQ_EOCSts__16BIT_STATUS_AUX_CTL_REG EQU CYREG_B0_UDB06_07_ACTL
TPS_ADC_bSAR_SEQ_EOCSts__16BIT_STATUS_REG EQU CYREG_B0_UDB06_07_ST
TPS_ADC_bSAR_SEQ_EOCSts__MASK EQU 0x01
TPS_ADC_bSAR_SEQ_EOCSts__MASK_REG EQU CYREG_B0_UDB06_MSK
TPS_ADC_bSAR_SEQ_EOCSts__STATUS_AUX_CTL_REG EQU CYREG_B0_UDB06_ACTL
TPS_ADC_bSAR_SEQ_EOCSts__STATUS_REG EQU CYREG_B0_UDB06_ST

/* TPS_ADC_FinalBuf */
TPS_ADC_FinalBuf__DRQ_CTL EQU CYREG_IDMUX_DRQ_CTL0
TPS_ADC_FinalBuf__DRQ_NUMBER EQU 2
TPS_ADC_FinalBuf__NUMBEROF_TDS EQU 0
TPS_ADC_FinalBuf__PRIORITY EQU 2
TPS_ADC_FinalBuf__TERMIN_EN EQU 0
TPS_ADC_FinalBuf__TERMIN_SEL EQU 0
TPS_ADC_FinalBuf__TERMOUT0_EN EQU 1
TPS_ADC_FinalBuf__TERMOUT0_SEL EQU 2
TPS_ADC_FinalBuf__TERMOUT1_EN EQU 0
TPS_ADC_FinalBuf__TERMOUT1_SEL EQU 0

/* TPS_ADC_IntClock */
TPS_ADC_IntClock__CFG0 EQU CYREG_CLKDIST_DCFG2_CFG0
TPS_ADC_IntClock__CFG1 EQU CYREG_CLKDIST_DCFG2_CFG1
TPS_ADC_IntClock__CFG2 EQU CYREG_CLKDIST_DCFG2_CFG2
TPS_ADC_IntClock__CFG2_SRC_SEL_MASK EQU 0x07
TPS_ADC_IntClock__INDEX EQU 0x02
TPS_ADC_IntClock__PM_ACT_CFG EQU CYREG_PM_ACT_CFG2
TPS_ADC_IntClock__PM_ACT_MSK EQU 0x04
TPS_ADC_IntClock__PM_STBY_CFG EQU CYREG_PM_STBY_CFG2
TPS_ADC_IntClock__PM_STBY_MSK EQU 0x04

/* TPS_ADC_IRQ */
TPS_ADC_IRQ__INTC_CLR_EN_REG EQU CYREG_NVIC_CLRENA0
TPS_ADC_IRQ__INTC_CLR_PD_REG EQU CYREG_NVIC_CLRPEND0
TPS_ADC_IRQ__INTC_MASK EQU 0x02
TPS_ADC_IRQ__INTC_NUMBER EQU 1
TPS_ADC_IRQ__INTC_PRIOR_NUM EQU 7
TPS_ADC_IRQ__INTC_PRIOR_REG EQU CYREG_NVIC_PRI_1
TPS_ADC_IRQ__INTC_SET_EN_REG EQU CYREG_NVIC_SETENA0
TPS_ADC_IRQ__INTC_SET_PD_REG EQU CYREG_NVIC_SETPEND0

/* TPS_ADC_SAR_ADC_SAR */
TPS_ADC_SAR_ADC_SAR__CLK EQU CYREG_SAR1_CLK
TPS_ADC_SAR_ADC_SAR__CSR0 EQU CYREG_SAR1_CSR0
TPS_ADC_SAR_ADC_SAR__CSR1 EQU CYREG_SAR1_CSR1
TPS_ADC_SAR_ADC_SAR__CSR2 EQU CYREG_SAR1_CSR2
TPS_ADC_SAR_ADC_SAR__CSR3 EQU CYREG_SAR1_CSR3
TPS_ADC_SAR_ADC_SAR__CSR4 EQU CYREG_SAR1_CSR4
TPS_ADC_SAR_ADC_SAR__CSR5 EQU CYREG_SAR1_CSR5
TPS_ADC_SAR_ADC_SAR__CSR6 EQU CYREG_SAR1_CSR6
TPS_ADC_SAR_ADC_SAR__PM_ACT_CFG EQU CYREG_PM_ACT_CFG11
TPS_ADC_SAR_ADC_SAR__PM_ACT_MSK EQU 0x02
TPS_ADC_SAR_ADC_SAR__PM_STBY_CFG EQU CYREG_PM_STBY_CFG11
TPS_ADC_SAR_ADC_SAR__PM_STBY_MSK EQU 0x02
TPS_ADC_SAR_ADC_SAR__SW0 EQU CYREG_SAR1_SW0
TPS_ADC_SAR_ADC_SAR__SW2 EQU CYREG_SAR1_SW2
TPS_ADC_SAR_ADC_SAR__SW3 EQU CYREG_SAR1_SW3
TPS_ADC_SAR_ADC_SAR__SW4 EQU CYREG_SAR1_SW4
TPS_ADC_SAR_ADC_SAR__SW6 EQU CYREG_SAR1_SW6
TPS_ADC_SAR_ADC_SAR__TR0 EQU CYREG_SAR1_TR0
TPS_ADC_SAR_ADC_SAR__WRK0 EQU CYREG_SAR1_WRK0
TPS_ADC_SAR_ADC_SAR__WRK1 EQU CYREG_SAR1_WRK1

/* TPS_ADC_TempBuf */
TPS_ADC_TempBuf__DRQ_CTL EQU CYREG_IDMUX_DRQ_CTL0
TPS_ADC_TempBuf__DRQ_NUMBER EQU 3
TPS_ADC_TempBuf__NUMBEROF_TDS EQU 0
TPS_ADC_TempBuf__PRIORITY EQU 2
TPS_ADC_TempBuf__TERMIN_EN EQU 0
TPS_ADC_TempBuf__TERMIN_SEL EQU 0
TPS_ADC_TempBuf__TERMOUT0_EN EQU 1
TPS_ADC_TempBuf__TERMOUT0_SEL EQU 3
TPS_ADC_TempBuf__TERMOUT1_EN EQU 0
TPS_ADC_TempBuf__TERMOUT1_SEL EQU 0

/* APPS_ADC_bSAR_SEQ */
APPS_ADC_bSAR_SEQ_ChannelCounter__16BIT_CONTROL_AUX_CTL_REG EQU CYREG_B1_UDB07_08_ACTL
APPS_ADC_bSAR_SEQ_ChannelCounter__16BIT_CONTROL_CONTROL_REG EQU CYREG_B1_UDB07_08_CTL
APPS_ADC_bSAR_SEQ_ChannelCounter__16BIT_CONTROL_COUNT_REG EQU CYREG_B1_UDB07_08_CTL
APPS_ADC_bSAR_SEQ_ChannelCounter__16BIT_COUNT_CONTROL_REG EQU CYREG_B1_UDB07_08_CTL
APPS_ADC_bSAR_SEQ_ChannelCounter__16BIT_COUNT_COUNT_REG EQU CYREG_B1_UDB07_08_CTL
APPS_ADC_bSAR_SEQ_ChannelCounter__16BIT_MASK_MASK_REG EQU CYREG_B1_UDB07_08_MSK
APPS_ADC_bSAR_SEQ_ChannelCounter__16BIT_MASK_PERIOD_REG EQU CYREG_B1_UDB07_08_MSK
APPS_ADC_bSAR_SEQ_ChannelCounter__16BIT_PERIOD_MASK_REG EQU CYREG_B1_UDB07_08_MSK
APPS_ADC_bSAR_SEQ_ChannelCounter__16BIT_PERIOD_PERIOD_REG EQU CYREG_B1_UDB07_08_MSK
APPS_ADC_bSAR_SEQ_ChannelCounter__CONTROL_AUX_CTL_REG EQU CYREG_B1_UDB07_ACTL
APPS_ADC_bSAR_SEQ_ChannelCounter__CONTROL_REG EQU CYREG_B1_UDB07_CTL
APPS_ADC_bSAR_SEQ_ChannelCounter__CONTROL_ST_REG EQU CYREG_B1_UDB07_ST_CTL
APPS_ADC_bSAR_SEQ_ChannelCounter__COUNT_REG EQU CYREG_B1_UDB07_CTL
APPS_ADC_bSAR_SEQ_ChannelCounter__COUNT_ST_REG EQU CYREG_B1_UDB07_ST_CTL
APPS_ADC_bSAR_SEQ_ChannelCounter__MASK_CTL_AUX_CTL_REG EQU CYREG_B1_UDB07_MSK_ACTL
APPS_ADC_bSAR_SEQ_ChannelCounter__PER_CTL_AUX_CTL_REG EQU CYREG_B1_UDB07_MSK_ACTL
APPS_ADC_bSAR_SEQ_ChannelCounter__PERIOD_REG EQU CYREG_B1_UDB07_MSK
APPS_ADC_bSAR_SEQ_ChannelCounter_ST__16BIT_STATUS_AUX_CTL_REG EQU CYREG_B1_UDB07_08_ACTL
APPS_ADC_bSAR_SEQ_ChannelCounter_ST__16BIT_STATUS_REG EQU CYREG_B1_UDB07_08_ST
APPS_ADC_bSAR_SEQ_ChannelCounter_ST__MASK_REG EQU CYREG_B1_UDB07_MSK
APPS_ADC_bSAR_SEQ_ChannelCounter_ST__MASK_ST_AUX_CTL_REG EQU CYREG_B1_UDB07_MSK_ACTL
APPS_ADC_bSAR_SEQ_ChannelCounter_ST__PER_ST_AUX_CTL_REG EQU CYREG_B1_UDB07_MSK_ACTL
APPS_ADC_bSAR_SEQ_ChannelCounter_ST__STATUS_AUX_CTL_REG EQU CYREG_B1_UDB07_ACTL
APPS_ADC_bSAR_SEQ_ChannelCounter_ST__STATUS_CNT_REG EQU CYREG_B1_UDB07_ST_CTL
APPS_ADC_bSAR_SEQ_ChannelCounter_ST__STATUS_CONTROL_REG EQU CYREG_B1_UDB07_ST_CTL
APPS_ADC_bSAR_SEQ_ChannelCounter_ST__STATUS_REG EQU CYREG_B1_UDB07_ST
APPS_ADC_bSAR_SEQ_CtrlReg__0__MASK EQU 0x01
APPS_ADC_bSAR_SEQ_CtrlReg__0__POS EQU 0
APPS_ADC_bSAR_SEQ_CtrlReg__1__MASK EQU 0x02
APPS_ADC_bSAR_SEQ_CtrlReg__1__POS EQU 1
APPS_ADC_bSAR_SEQ_CtrlReg__16BIT_CONTROL_AUX_CTL_REG EQU CYREG_B0_UDB07_08_ACTL
APPS_ADC_bSAR_SEQ_CtrlReg__16BIT_CONTROL_CONTROL_REG EQU CYREG_B0_UDB07_08_CTL
APPS_ADC_bSAR_SEQ_CtrlReg__16BIT_CONTROL_COUNT_REG EQU CYREG_B0_UDB07_08_CTL
APPS_ADC_bSAR_SEQ_CtrlReg__16BIT_COUNT_CONTROL_REG EQU CYREG_B0_UDB07_08_CTL
APPS_ADC_bSAR_SEQ_CtrlReg__16BIT_COUNT_COUNT_REG EQU CYREG_B0_UDB07_08_CTL
APPS_ADC_bSAR_SEQ_CtrlReg__16BIT_MASK_MASK_REG EQU CYREG_B0_UDB07_08_MSK
APPS_ADC_bSAR_SEQ_CtrlReg__16BIT_MASK_PERIOD_REG EQU CYREG_B0_UDB07_08_MSK
APPS_ADC_bSAR_SEQ_CtrlReg__16BIT_PERIOD_MASK_REG EQU CYREG_B0_UDB07_08_MSK
APPS_ADC_bSAR_SEQ_CtrlReg__16BIT_PERIOD_PERIOD_REG EQU CYREG_B0_UDB07_08_MSK
APPS_ADC_bSAR_SEQ_CtrlReg__CONTROL_AUX_CTL_REG EQU CYREG_B0_UDB07_ACTL
APPS_ADC_bSAR_SEQ_CtrlReg__CONTROL_REG EQU CYREG_B0_UDB07_CTL
APPS_ADC_bSAR_SEQ_CtrlReg__CONTROL_ST_REG EQU CYREG_B0_UDB07_ST_CTL
APPS_ADC_bSAR_SEQ_CtrlReg__COUNT_REG EQU CYREG_B0_UDB07_CTL
APPS_ADC_bSAR_SEQ_CtrlReg__COUNT_ST_REG EQU CYREG_B0_UDB07_ST_CTL
APPS_ADC_bSAR_SEQ_CtrlReg__MASK EQU 0x03
APPS_ADC_bSAR_SEQ_CtrlReg__MASK_CTL_AUX_CTL_REG EQU CYREG_B0_UDB07_MSK_ACTL
APPS_ADC_bSAR_SEQ_CtrlReg__PER_CTL_AUX_CTL_REG EQU CYREG_B0_UDB07_MSK_ACTL
APPS_ADC_bSAR_SEQ_CtrlReg__PERIOD_REG EQU CYREG_B0_UDB07_MSK
APPS_ADC_bSAR_SEQ_EOCSts__0__MASK EQU 0x01
APPS_ADC_bSAR_SEQ_EOCSts__0__POS EQU 0
APPS_ADC_bSAR_SEQ_EOCSts__16BIT_STATUS_AUX_CTL_REG EQU CYREG_B0_UDB04_05_ACTL
APPS_ADC_bSAR_SEQ_EOCSts__16BIT_STATUS_REG EQU CYREG_B0_UDB04_05_ST
APPS_ADC_bSAR_SEQ_EOCSts__MASK EQU 0x01
APPS_ADC_bSAR_SEQ_EOCSts__MASK_REG EQU CYREG_B0_UDB04_MSK
APPS_ADC_bSAR_SEQ_EOCSts__STATUS_AUX_CTL_REG EQU CYREG_B0_UDB04_ACTL
APPS_ADC_bSAR_SEQ_EOCSts__STATUS_REG EQU CYREG_B0_UDB04_ST

/* APPS_ADC_FinalBuf */
APPS_ADC_FinalBuf__DRQ_CTL EQU CYREG_IDMUX_DRQ_CTL0
APPS_ADC_FinalBuf__DRQ_NUMBER EQU 0
APPS_ADC_FinalBuf__NUMBEROF_TDS EQU 0
APPS_ADC_FinalBuf__PRIORITY EQU 2
APPS_ADC_FinalBuf__TERMIN_EN EQU 0
APPS_ADC_FinalBuf__TERMIN_SEL EQU 0
APPS_ADC_FinalBuf__TERMOUT0_EN EQU 1
APPS_ADC_FinalBuf__TERMOUT0_SEL EQU 0
APPS_ADC_FinalBuf__TERMOUT1_EN EQU 0
APPS_ADC_FinalBuf__TERMOUT1_SEL EQU 0

/* APPS_ADC_IntClock */
APPS_ADC_IntClock__CFG0 EQU CYREG_CLKDIST_DCFG1_CFG0
APPS_ADC_IntClock__CFG1 EQU CYREG_CLKDIST_DCFG1_CFG1
APPS_ADC_IntClock__CFG2 EQU CYREG_CLKDIST_DCFG1_CFG2
APPS_ADC_IntClock__CFG2_SRC_SEL_MASK EQU 0x07
APPS_ADC_IntClock__INDEX EQU 0x01
APPS_ADC_IntClock__PM_ACT_CFG EQU CYREG_PM_ACT_CFG2
APPS_ADC_IntClock__PM_ACT_MSK EQU 0x02
APPS_ADC_IntClock__PM_STBY_CFG EQU CYREG_PM_STBY_CFG2
APPS_ADC_IntClock__PM_STBY_MSK EQU 0x02

/* APPS_ADC_IRQ */
APPS_ADC_IRQ__INTC_CLR_EN_REG EQU CYREG_NVIC_CLRENA0
APPS_ADC_IRQ__INTC_CLR_PD_REG EQU CYREG_NVIC_CLRPEND0
APPS_ADC_IRQ__INTC_MASK EQU 0x01
APPS_ADC_IRQ__INTC_NUMBER EQU 0
APPS_ADC_IRQ__INTC_PRIOR_NUM EQU 7
APPS_ADC_IRQ__INTC_PRIOR_REG EQU CYREG_NVIC_PRI_0
APPS_ADC_IRQ__INTC_SET_EN_REG EQU CYREG_NVIC_SETENA0
APPS_ADC_IRQ__INTC_SET_PD_REG EQU CYREG_NVIC_SETPEND0

/* APPS_ADC_SAR_ADC_SAR */
APPS_ADC_SAR_ADC_SAR__CLK EQU CYREG_SAR0_CLK
APPS_ADC_SAR_ADC_SAR__CSR0 EQU CYREG_SAR0_CSR0
APPS_ADC_SAR_ADC_SAR__CSR1 EQU CYREG_SAR0_CSR1
APPS_ADC_SAR_ADC_SAR__CSR2 EQU CYREG_SAR0_CSR2
APPS_ADC_SAR_ADC_SAR__CSR3 EQU CYREG_SAR0_CSR3
APPS_ADC_SAR_ADC_SAR__CSR4 EQU CYREG_SAR0_CSR4
APPS_ADC_SAR_ADC_SAR__CSR5 EQU CYREG_SAR0_CSR5
APPS_ADC_SAR_ADC_SAR__CSR6 EQU CYREG_SAR0_CSR6
APPS_ADC_SAR_ADC_SAR__PM_ACT_CFG EQU CYREG_PM_ACT_CFG11
APPS_ADC_SAR_ADC_SAR__PM_ACT_MSK EQU 0x01
APPS_ADC_SAR_ADC_SAR__PM_STBY_CFG EQU CYREG_PM_STBY_CFG11
APPS_ADC_SAR_ADC_SAR__PM_STBY_MSK EQU 0x01
APPS_ADC_SAR_ADC_SAR__SW0 EQU CYREG_SAR0_SW0
APPS_ADC_SAR_ADC_SAR__SW2 EQU CYREG_SAR0_SW2
APPS_ADC_SAR_ADC_SAR__SW3 EQU CYREG_SAR0_SW3
APPS_ADC_SAR_ADC_SAR__SW4 EQU CYREG_SAR0_SW4
APPS_ADC_SAR_ADC_SAR__SW6 EQU CYREG_SAR0_SW6
APPS_ADC_SAR_ADC_SAR__TR0 EQU CYREG_SAR0_TR0
APPS_ADC_SAR_ADC_SAR__WRK0 EQU CYREG_SAR0_WRK0
APPS_ADC_SAR_ADC_SAR__WRK1 EQU CYREG_SAR0_WRK1

/* APPS_ADC_TempBuf */
APPS_ADC_TempBuf__DRQ_CTL EQU CYREG_IDMUX_DRQ_CTL0
APPS_ADC_TempBuf__DRQ_NUMBER EQU 1
APPS_ADC_TempBuf__NUMBEROF_TDS EQU 0
APPS_ADC_TempBuf__PRIORITY EQU 2
APPS_ADC_TempBuf__TERMIN_EN EQU 0
APPS_ADC_TempBuf__TERMIN_SEL EQU 0
APPS_ADC_TempBuf__TERMOUT0_EN EQU 1
APPS_ADC_TempBuf__TERMOUT0_SEL EQU 1
APPS_ADC_TempBuf__TERMOUT1_EN EQU 0
APPS_ADC_TempBuf__TERMOUT1_SEL EQU 0

/* SERVO_OUT */
SERVO_OUT__0__MASK EQU 0x01
SERVO_OUT__0__PC EQU CYREG_PRT0_PC0
SERVO_OUT__0__PORT EQU 0
SERVO_OUT__0__SHIFT EQU 0
SERVO_OUT__AG EQU CYREG_PRT0_AG
SERVO_OUT__AMUX EQU CYREG_PRT0_AMUX
SERVO_OUT__BIE EQU CYREG_PRT0_BIE
SERVO_OUT__BIT_MASK EQU CYREG_PRT0_BIT_MASK
SERVO_OUT__BYP EQU CYREG_PRT0_BYP
SERVO_OUT__CTL EQU CYREG_PRT0_CTL
SERVO_OUT__DM0 EQU CYREG_PRT0_DM0
SERVO_OUT__DM1 EQU CYREG_PRT0_DM1
SERVO_OUT__DM2 EQU CYREG_PRT0_DM2
SERVO_OUT__DR EQU CYREG_PRT0_DR
SERVO_OUT__INP_DIS EQU CYREG_PRT0_INP_DIS
SERVO_OUT__LCD_COM_SEG EQU CYREG_PRT0_LCD_COM_SEG
SERVO_OUT__LCD_EN EQU CYREG_PRT0_LCD_EN
SERVO_OUT__MASK EQU 0x01
SERVO_OUT__PORT EQU 0
SERVO_OUT__PRT EQU CYREG_PRT0_PRT
SERVO_OUT__PRTDSI__CAPS_SEL EQU CYREG_PRT0_CAPS_SEL
SERVO_OUT__PRTDSI__DBL_SYNC_IN EQU CYREG_PRT0_DBL_SYNC_IN
SERVO_OUT__PRTDSI__OE_SEL0 EQU CYREG_PRT0_OE_SEL0
SERVO_OUT__PRTDSI__OE_SEL1 EQU CYREG_PRT0_OE_SEL1
SERVO_OUT__PRTDSI__OUT_SEL0 EQU CYREG_PRT0_OUT_SEL0
SERVO_OUT__PRTDSI__OUT_SEL1 EQU CYREG_PRT0_OUT_SEL1
SERVO_OUT__PRTDSI__SYNC_OUT EQU CYREG_PRT0_SYNC_OUT
SERVO_OUT__PS EQU CYREG_PRT0_PS
SERVO_OUT__SHIFT EQU 0
SERVO_OUT__SLW EQU CYREG_PRT0_SLW

/* SERVO_PWM_PWMUDB */
SERVO_PWM_PWMUDB_genblk1_ctrlreg__16BIT_CONTROL_AUX_CTL_REG EQU CYREG_B0_UDB01_02_ACTL
SERVO_PWM_PWMUDB_genblk1_ctrlreg__16BIT_CONTROL_CONTROL_REG EQU CYREG_B0_UDB01_02_CTL
SERVO_PWM_PWMUDB_genblk1_ctrlreg__16BIT_CONTROL_COUNT_REG EQU CYREG_B0_UDB01_02_CTL
SERVO_PWM_PWMUDB_genblk1_ctrlreg__16BIT_COUNT_CONTROL_REG EQU CYREG_B0_UDB01_02_CTL
SERVO_PWM_PWMUDB_genblk1_ctrlreg__16BIT_COUNT_COUNT_REG EQU CYREG_B0_UDB01_02_CTL
SERVO_PWM_PWMUDB_genblk1_ctrlreg__16BIT_MASK_MASK_REG EQU CYREG_B0_UDB01_02_MSK
SERVO_PWM_PWMUDB_genblk1_ctrlreg__16BIT_MASK_PERIOD_REG EQU CYREG_B0_UDB01_02_MSK
SERVO_PWM_PWMUDB_genblk1_ctrlreg__16BIT_PERIOD_MASK_REG EQU CYREG_B0_UDB01_02_MSK
SERVO_PWM_PWMUDB_genblk1_ctrlreg__16BIT_PERIOD_PERIOD_REG EQU CYREG_B0_UDB01_02_MSK
SERVO_PWM_PWMUDB_genblk1_ctrlreg__7__MASK EQU 0x80
SERVO_PWM_PWMUDB_genblk1_ctrlreg__7__POS EQU 7
SERVO_PWM_PWMUDB_genblk1_ctrlreg__CONTROL_AUX_CTL_REG EQU CYREG_B0_UDB01_ACTL
SERVO_PWM_PWMUDB_genblk1_ctrlreg__CONTROL_REG EQU CYREG_B0_UDB01_CTL
SERVO_PWM_PWMUDB_genblk1_ctrlreg__CONTROL_ST_REG EQU CYREG_B0_UDB01_ST_CTL
SERVO_PWM_PWMUDB_genblk1_ctrlreg__COUNT_REG EQU CYREG_B0_UDB01_CTL
SERVO_PWM_PWMUDB_genblk1_ctrlreg__COUNT_ST_REG EQU CYREG_B0_UDB01_ST_CTL
SERVO_PWM_PWMUDB_genblk1_ctrlreg__MASK EQU 0x80
SERVO_PWM_PWMUDB_genblk1_ctrlreg__MASK_CTL_AUX_CTL_REG EQU CYREG_B0_UDB01_MSK_ACTL
SERVO_PWM_PWMUDB_genblk1_ctrlreg__PER_CTL_AUX_CTL_REG EQU CYREG_B0_UDB01_MSK_ACTL
SERVO_PWM_PWMUDB_genblk1_ctrlreg__PERIOD_REG EQU CYREG_B0_UDB01_MSK
SERVO_PWM_PWMUDB_genblk8_stsreg__0__MASK EQU 0x01
SERVO_PWM_PWMUDB_genblk8_stsreg__0__POS EQU 0
SERVO_PWM_PWMUDB_genblk8_stsreg__1__MASK EQU 0x02
SERVO_PWM_PWMUDB_genblk8_stsreg__1__POS EQU 1
SERVO_PWM_PWMUDB_genblk8_stsreg__16BIT_STATUS_AUX_CTL_REG EQU CYREG_B0_UDB01_02_ACTL
SERVO_PWM_PWMUDB_genblk8_stsreg__16BIT_STATUS_REG EQU CYREG_B0_UDB01_02_ST
SERVO_PWM_PWMUDB_genblk8_stsreg__2__MASK EQU 0x04
SERVO_PWM_PWMUDB_genblk8_stsreg__2__POS EQU 2
SERVO_PWM_PWMUDB_genblk8_stsreg__3__MASK EQU 0x08
SERVO_PWM_PWMUDB_genblk8_stsreg__3__POS EQU 3
SERVO_PWM_PWMUDB_genblk8_stsreg__MASK EQU 0x0F
SERVO_PWM_PWMUDB_genblk8_stsreg__MASK_REG EQU CYREG_B0_UDB01_MSK
SERVO_PWM_PWMUDB_genblk8_stsreg__MASK_ST_AUX_CTL_REG EQU CYREG_B0_UDB01_MSK_ACTL
SERVO_PWM_PWMUDB_genblk8_stsreg__PER_ST_AUX_CTL_REG EQU CYREG_B0_UDB01_MSK_ACTL
SERVO_PWM_PWMUDB_genblk8_stsreg__STATUS_AUX_CTL_REG EQU CYREG_B0_UDB01_ACTL
SERVO_PWM_PWMUDB_genblk8_stsreg__STATUS_CNT_REG EQU CYREG_B0_UDB01_ST_CTL
SERVO_PWM_PWMUDB_genblk8_stsreg__STATUS_CONTROL_REG EQU CYREG_B0_UDB01_ST_CTL
SERVO_PWM_PWMUDB_genblk8_stsreg__STATUS_REG EQU CYREG_B0_UDB01_ST
SERVO_PWM_PWMUDB_sP8_pwmdp_u0__16BIT_A0_REG EQU CYREG_B0_UDB01_02_A0
SERVO_PWM_PWMUDB_sP8_pwmdp_u0__16BIT_A1_REG EQU CYREG_B0_UDB01_02_A1
SERVO_PWM_PWMUDB_sP8_pwmdp_u0__16BIT_D0_REG EQU CYREG_B0_UDB01_02_D0
SERVO_PWM_PWMUDB_sP8_pwmdp_u0__16BIT_D1_REG EQU CYREG_B0_UDB01_02_D1
SERVO_PWM_PWMUDB_sP8_pwmdp_u0__16BIT_DP_AUX_CTL_REG EQU CYREG_B0_UDB01_02_ACTL
SERVO_PWM_PWMUDB_sP8_pwmdp_u0__16BIT_F0_REG EQU CYREG_B0_UDB01_02_F0
SERVO_PWM_PWMUDB_sP8_pwmdp_u0__16BIT_F1_REG EQU CYREG_B0_UDB01_02_F1
SERVO_PWM_PWMUDB_sP8_pwmdp_u0__A0_A1_REG EQU CYREG_B0_UDB01_A0_A1
SERVO_PWM_PWMUDB_sP8_pwmdp_u0__A0_REG EQU CYREG_B0_UDB01_A0
SERVO_PWM_PWMUDB_sP8_pwmdp_u0__A1_REG EQU CYREG_B0_UDB01_A1
SERVO_PWM_PWMUDB_sP8_pwmdp_u0__D0_D1_REG EQU CYREG_B0_UDB01_D0_D1
SERVO_PWM_PWMUDB_sP8_pwmdp_u0__D0_REG EQU CYREG_B0_UDB01_D0
SERVO_PWM_PWMUDB_sP8_pwmdp_u0__D1_REG EQU CYREG_B0_UDB01_D1
SERVO_PWM_PWMUDB_sP8_pwmdp_u0__DP_AUX_CTL_REG EQU CYREG_B0_UDB01_ACTL
SERVO_PWM_PWMUDB_sP8_pwmdp_u0__F0_F1_REG EQU CYREG_B0_UDB01_F0_F1
SERVO_PWM_PWMUDB_sP8_pwmdp_u0__F0_REG EQU CYREG_B0_UDB01_F0
SERVO_PWM_PWMUDB_sP8_pwmdp_u0__F1_REG EQU CYREG_B0_UDB01_F1
SERVO_PWM_PWMUDB_sP8_pwmdp_u0__MSK_DP_AUX_CTL_REG EQU CYREG_B0_UDB01_MSK_ACTL
SERVO_PWM_PWMUDB_sP8_pwmdp_u0__PER_DP_AUX_CTL_REG EQU CYREG_B0_UDB01_MSK_ACTL

/* Miscellaneous */
BCLK__BUS_CLK__HZ EQU 24000000
BCLK__BUS_CLK__KHZ EQU 24000
BCLK__BUS_CLK__MHZ EQU 24
CYDEV_CHIP_DIE_GEN4 EQU 2
CYDEV_CHIP_DIE_LEOPARD EQU 1
CYDEV_CHIP_DIE_PANTHER EQU 13
CYDEV_CHIP_DIE_PSOC4A EQU 6
CYDEV_CHIP_DIE_PSOC5LP EQU 12
CYDEV_CHIP_DIE_UNKNOWN EQU 0
CYDEV_CHIP_FAMILY_PSOC3 EQU 1
CYDEV_CHIP_FAMILY_PSOC4 EQU 2
CYDEV_CHIP_FAMILY_PSOC5 EQU 3
CYDEV_CHIP_FAMILY_UNKNOWN EQU 0
CYDEV_CHIP_FAMILY_USED EQU CYDEV_CHIP_FAMILY_PSOC5
CYDEV_CHIP_JTAG_ID EQU 0x2E123069
CYDEV_CHIP_MEMBER_3A EQU 1
CYDEV_CHIP_MEMBER_4A EQU 6
CYDEV_CHIP_MEMBER_4C EQU 10
CYDEV_CHIP_MEMBER_4D EQU 3
CYDEV_CHIP_MEMBER_4E EQU 5
CYDEV_CHIP_MEMBER_4F EQU 7
CYDEV_CHIP_MEMBER_4G EQU 2
CYDEV_CHIP_MEMBER_4H EQU 4
CYDEV_CHIP_MEMBER_4L EQU 9
CYDEV_CHIP_MEMBER_4M EQU 8
CYDEV_CHIP_MEMBER_5A EQU 12
CYDEV_CHIP_MEMBER_5B EQU 11
CYDEV_CHIP_MEMBER_UNKNOWN EQU 0
CYDEV_CHIP_MEMBER_USED EQU CYDEV_CHIP_MEMBER_5B
CYDEV_CHIP_DIE_EXPECT EQU CYDEV_CHIP_MEMBER_USED
CYDEV_CHIP_DIE_ACTUAL EQU CYDEV_CHIP_DIE_EXPECT
CYDEV_CHIP_REV_GEN4_ES EQU 17
CYDEV_CHIP_REV_GEN4_ES2 EQU 33
CYDEV_CHIP_REV_GEN4_PRODUCTION EQU 17
CYDEV_CHIP_REV_LEOPARD_ES1 EQU 0
CYDEV_CHIP_REV_LEOPARD_ES2 EQU 1
CYDEV_CHIP_REV_LEOPARD_ES3 EQU 3
CYDEV_CHIP_REV_LEOPARD_PRODUCTION EQU 3
CYDEV_CHIP_REV_PANTHER_ES0 EQU 0
CYDEV_CHIP_REV_PANTHER_ES1 EQU 1
CYDEV_CHIP_REV_PANTHER_PRODUCTION EQU 1
CYDEV_CHIP_REV_PSOC4A_ES0 EQU 17
CYDEV_CHIP_REV_PSOC4A_PRODUCTION EQU 17
CYDEV_CHIP_REV_PSOC5LP_ES0 EQU 0
CYDEV_CHIP_REV_PSOC5LP_PRODUCTION EQU 0
CYDEV_CHIP_REVISION_3A_ES1 EQU 0
CYDEV_CHIP_REVISION_3A_ES2 EQU 1
CYDEV_CHIP_REVISION_3A_ES3 EQU 3
CYDEV_CHIP_REVISION_3A_PRODUCTION EQU 3
CYDEV_CHIP_REVISION_4A_ES0 EQU 17
CYDEV_CHIP_REVISION_4A_PRODUCTION EQU 17
CYDEV_CHIP_REVISION_4C_PRODUCTION EQU 0
CYDEV_CHIP_REVISION_4D_PRODUCTION EQU 0
CYDEV_CHIP_REVISION_4E_PRODUCTION EQU 0
CYDEV_CHIP_REVISION_4F_PRODUCTION EQU 0
CYDEV_CHIP_REVISION_4F_PRODUCTION_256K EQU 0
CYDEV_CHIP_REVISION_4G_ES EQU 17
CYDEV_CHIP_REVISION_4G_ES2 EQU 33
CYDEV_CHIP_REVISION_4G_PRODUCTION EQU 17
CYDEV_CHIP_REVISION_4H_PRODUCTION EQU 0
CYDEV_CHIP_REVISION_4L_PRODUCTION EQU 0
CYDEV_CHIP_REVISION_4M_PRODUCTION EQU 0
CYDEV_CHIP_REVISION_5A_ES0 EQU 0
CYDEV_CHIP_REVISION_5A_ES1 EQU 1
CYDEV_CHIP_REVISION_5A_PRODUCTION EQU 1
CYDEV_CHIP_REVISION_5B_ES0 EQU 0
CYDEV_CHIP_REVISION_5B_PRODUCTION EQU 0
CYDEV_CHIP_REVISION_USED EQU CYDEV_CHIP_REVISION_5B_PRODUCTION
CYDEV_CHIP_REV_EXPECT EQU CYDEV_CHIP_REVISION_USED
CYDEV_CONFIG_FASTBOOT_ENABLED EQU 1
CYDEV_CONFIG_UNUSED_IO_AllowButWarn EQU 0
CYDEV_CONFIG_UNUSED_IO EQU CYDEV_CONFIG_UNUSED_IO_AllowButWarn
CYDEV_CONFIG_UNUSED_IO_AllowWithInfo EQU 1
CYDEV_CONFIG_UNUSED_IO_Disallowed EQU 2
CYDEV_CONFIGURATION_COMPRESSED EQU 1
CYDEV_CONFIGURATION_DMA EQU 0
CYDEV_CONFIGURATION_ECC EQU 1
CYDEV_CONFIGURATION_IMOENABLED EQU CYDEV_CONFIG_FASTBOOT_ENABLED
CYDEV_CONFIGURATION_MODE_COMPRESSED EQU 0
CYDEV_CONFIGURATION_MODE EQU CYDEV_CONFIGURATION_MODE_COMPRESSED
CYDEV_CONFIGURATION_MODE_DMA EQU 2
CYDEV_CONFIGURATION_MODE_UNCOMPRESSED EQU 1
CYDEV_DEBUG_ENABLE_MASK EQU 0x20
CYDEV_DEBUG_ENABLE_REGISTER EQU CYREG_MLOGIC_DEBUG
CYDEV_DEBUGGING_DPS_Disable EQU 3
CYDEV_DEBUGGING_DPS_JTAG_4 EQU 1
CYDEV_DEBUGGING_DPS_JTAG_5 EQU 0
CYDEV_DEBUGGING_DPS_SWD EQU 2
CYDEV_DEBUGGING_DPS_SWD_SWV EQU 6
CYDEV_DEBUGGING_DPS EQU CYDEV_DEBUGGING_DPS_SWD_SWV
CYDEV_DEBUGGING_ENABLE EQU 1
CYDEV_DEBUGGING_XRES EQU 0
CYDEV_DMA_CHANNELS_AVAILABLE EQU 24
CYDEV_ECC_ENABLE EQU 0
CYDEV_HEAP_SIZE EQU 0x80
CYDEV_INSTRUCT_CACHE_ENABLED EQU 1
CYDEV_INTR_RISING EQU 0x00000003
CYDEV_PROJ_TYPE EQU 0
CYDEV_PROJ_TYPE_BOOTLOADER EQU 1
CYDEV_PROJ_TYPE_LAUNCHER EQU 5
CYDEV_PROJ_TYPE_LOADABLE EQU 2
CYDEV_PROJ_TYPE_LOADABLEANDBOOTLOADER EQU 4
CYDEV_PROJ_TYPE_MULTIAPPBOOTLOADER EQU 3
CYDEV_PROJ_TYPE_STANDARD EQU 0
CYDEV_PROTECTION_ENABLE EQU 0
CYDEV_STACK_SIZE EQU 0x0800
CYDEV_USE_BUNDLED_CMSIS EQU 1
CYDEV_VARIABLE_VDDA EQU 0
CYDEV_VDDA_MV EQU 5000
CYDEV_VDDD_MV EQU 5000
CYDEV_VDDIO0_MV EQU 5000
CYDEV_VDDIO1_MV EQU 5000
CYDEV_VDDIO2_MV EQU 5000
CYDEV_VDDIO3_MV EQU 5000
CYDEV_VIO0_MV EQU 5000
CYDEV_VIO1_MV EQU 5000
CYDEV_VIO2_MV EQU 5000
CYDEV_VIO3_MV EQU 5000
CYIPBLOCK_ARM_CM3_VERSION EQU 0
CYIPBLOCK_P3_ANAIF_VERSION EQU 0
CYIPBLOCK_P3_CAN_VERSION EQU 0
CYIPBLOCK_P3_CAPSENSE_VERSION EQU 0
CYIPBLOCK_P3_COMP_VERSION EQU 0
CYIPBLOCK_P3_DECIMATOR_VERSION EQU 0
CYIPBLOCK_P3_DFB_VERSION EQU 0
CYIPBLOCK_P3_DMA_VERSION EQU 0
CYIPBLOCK_P3_DRQ_VERSION EQU 0
CYIPBLOCK_P3_DSM_VERSION EQU 0
CYIPBLOCK_P3_EMIF_VERSION EQU 0
CYIPBLOCK_P3_I2C_VERSION EQU 0
CYIPBLOCK_P3_LCD_VERSION EQU 0
CYIPBLOCK_P3_LPF_VERSION EQU 0
CYIPBLOCK_P3_OPAMP_VERSION EQU 0
CYIPBLOCK_P3_PM_VERSION EQU 0
CYIPBLOCK_P3_SCCT_VERSION EQU 0
CYIPBLOCK_P3_TIMER_VERSION EQU 0
CYIPBLOCK_P3_USB_VERSION EQU 0
CYIPBLOCK_P3_VIDAC_VERSION EQU 0
CYIPBLOCK_P3_VREF_VERSION EQU 0
CYIPBLOCK_S8_GPIO_VERSION EQU 0
CYIPBLOCK_S8_IRQ_VERSION EQU 0
CYIPBLOCK_S8_SAR_VERSION EQU 0
CYIPBLOCK_S8_SIO_VERSION EQU 0
CYIPBLOCK_S8_UDB_VERSION EQU 0
DMA_CHANNELS_USED__MASK0 EQU 0x0000000F
CYDEV_BOOTLOADER_ENABLE EQU 0

#endif /* INCLUDED_CYFITTERIAR_INC */
