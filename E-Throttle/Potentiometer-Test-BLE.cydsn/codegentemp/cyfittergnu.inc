.ifndef INCLUDED_CYFITTERGNU_INC
.set INCLUDED_CYFITTERGNU_INC, 1
.include "cydevicegnu_trm.inc"

/* PWM_1_cy_m0s8_tcpwm_1 */
.set PWM_1_cy_m0s8_tcpwm_1__CC, CYREG_TCPWM_CNT0_CC
.set PWM_1_cy_m0s8_tcpwm_1__CC_BUFF, CYREG_TCPWM_CNT0_CC_BUFF
.set PWM_1_cy_m0s8_tcpwm_1__COUNTER, CYREG_TCPWM_CNT0_COUNTER
.set PWM_1_cy_m0s8_tcpwm_1__CTRL, CYREG_TCPWM_CNT0_CTRL
.set PWM_1_cy_m0s8_tcpwm_1__INTR, CYREG_TCPWM_CNT0_INTR
.set PWM_1_cy_m0s8_tcpwm_1__INTR_MASK, CYREG_TCPWM_CNT0_INTR_MASK
.set PWM_1_cy_m0s8_tcpwm_1__INTR_MASKED, CYREG_TCPWM_CNT0_INTR_MASKED
.set PWM_1_cy_m0s8_tcpwm_1__INTR_SET, CYREG_TCPWM_CNT0_INTR_SET
.set PWM_1_cy_m0s8_tcpwm_1__PERIOD, CYREG_TCPWM_CNT0_PERIOD
.set PWM_1_cy_m0s8_tcpwm_1__PERIOD_BUFF, CYREG_TCPWM_CNT0_PERIOD_BUFF
.set PWM_1_cy_m0s8_tcpwm_1__STATUS, CYREG_TCPWM_CNT0_STATUS
.set PWM_1_cy_m0s8_tcpwm_1__TCPWM_CMD, CYREG_TCPWM_CMD
.set PWM_1_cy_m0s8_tcpwm_1__TCPWM_CMDCAPTURE_MASK, 0x01
.set PWM_1_cy_m0s8_tcpwm_1__TCPWM_CMDCAPTURE_SHIFT, 0
.set PWM_1_cy_m0s8_tcpwm_1__TCPWM_CMDRELOAD_MASK, 0x100
.set PWM_1_cy_m0s8_tcpwm_1__TCPWM_CMDRELOAD_SHIFT, 8
.set PWM_1_cy_m0s8_tcpwm_1__TCPWM_CMDSTART_MASK, 0x1000000
.set PWM_1_cy_m0s8_tcpwm_1__TCPWM_CMDSTART_SHIFT, 24
.set PWM_1_cy_m0s8_tcpwm_1__TCPWM_CMDSTOP_MASK, 0x10000
.set PWM_1_cy_m0s8_tcpwm_1__TCPWM_CMDSTOP_SHIFT, 16
.set PWM_1_cy_m0s8_tcpwm_1__TCPWM_CTRL, CYREG_TCPWM_CTRL
.set PWM_1_cy_m0s8_tcpwm_1__TCPWM_CTRL_MASK, 0x01
.set PWM_1_cy_m0s8_tcpwm_1__TCPWM_CTRL_SHIFT, 0
.set PWM_1_cy_m0s8_tcpwm_1__TCPWM_INTR_CAUSE, CYREG_TCPWM_INTR_CAUSE
.set PWM_1_cy_m0s8_tcpwm_1__TCPWM_INTR_CAUSE_MASK, 0x01
.set PWM_1_cy_m0s8_tcpwm_1__TCPWM_INTR_CAUSE_SHIFT, 0
.set PWM_1_cy_m0s8_tcpwm_1__TCPWM_NUMBER, 0
.set PWM_1_cy_m0s8_tcpwm_1__TR_CTRL0, CYREG_TCPWM_CNT0_TR_CTRL0
.set PWM_1_cy_m0s8_tcpwm_1__TR_CTRL1, CYREG_TCPWM_CNT0_TR_CTRL1
.set PWM_1_cy_m0s8_tcpwm_1__TR_CTRL2, CYREG_TCPWM_CNT0_TR_CTRL2

/* Pin_1 */
.set Pin_1__0__DR, CYREG_GPIO_PRT2_DR
.set Pin_1__0__DR_CLR, CYREG_GPIO_PRT2_DR_CLR
.set Pin_1__0__DR_INV, CYREG_GPIO_PRT2_DR_INV
.set Pin_1__0__DR_SET, CYREG_GPIO_PRT2_DR_SET
.set Pin_1__0__HSIOM, CYREG_HSIOM_PORT_SEL2
.set Pin_1__0__HSIOM_MASK, 0x0000000F
.set Pin_1__0__HSIOM_SHIFT, 0
.set Pin_1__0__INTCFG, CYREG_GPIO_PRT2_INTR_CFG
.set Pin_1__0__INTR, CYREG_GPIO_PRT2_INTR
.set Pin_1__0__INTR_CFG, CYREG_GPIO_PRT2_INTR_CFG
.set Pin_1__0__INTSTAT, CYREG_GPIO_PRT2_INTR
.set Pin_1__0__MASK, 0x01
.set Pin_1__0__OUT_SEL, CYREG_UDB_PA2_CFG10
.set Pin_1__0__OUT_SEL_SHIFT, 0
.set Pin_1__0__OUT_SEL_VAL, 0
.set Pin_1__0__PA__CFG0, CYREG_UDB_PA2_CFG0
.set Pin_1__0__PA__CFG1, CYREG_UDB_PA2_CFG1
.set Pin_1__0__PA__CFG10, CYREG_UDB_PA2_CFG10
.set Pin_1__0__PA__CFG11, CYREG_UDB_PA2_CFG11
.set Pin_1__0__PA__CFG12, CYREG_UDB_PA2_CFG12
.set Pin_1__0__PA__CFG13, CYREG_UDB_PA2_CFG13
.set Pin_1__0__PA__CFG14, CYREG_UDB_PA2_CFG14
.set Pin_1__0__PA__CFG2, CYREG_UDB_PA2_CFG2
.set Pin_1__0__PA__CFG3, CYREG_UDB_PA2_CFG3
.set Pin_1__0__PA__CFG4, CYREG_UDB_PA2_CFG4
.set Pin_1__0__PA__CFG5, CYREG_UDB_PA2_CFG5
.set Pin_1__0__PA__CFG6, CYREG_UDB_PA2_CFG6
.set Pin_1__0__PA__CFG7, CYREG_UDB_PA2_CFG7
.set Pin_1__0__PA__CFG8, CYREG_UDB_PA2_CFG8
.set Pin_1__0__PA__CFG9, CYREG_UDB_PA2_CFG9
.set Pin_1__0__PC, CYREG_GPIO_PRT2_PC
.set Pin_1__0__PC2, CYREG_GPIO_PRT2_PC2
.set Pin_1__0__PORT, 2
.set Pin_1__0__PS, CYREG_GPIO_PRT2_PS
.set Pin_1__0__SHIFT, 0
.set Pin_1__DR, CYREG_GPIO_PRT2_DR
.set Pin_1__DR_CLR, CYREG_GPIO_PRT2_DR_CLR
.set Pin_1__DR_INV, CYREG_GPIO_PRT2_DR_INV
.set Pin_1__DR_SET, CYREG_GPIO_PRT2_DR_SET
.set Pin_1__INTCFG, CYREG_GPIO_PRT2_INTR_CFG
.set Pin_1__INTR, CYREG_GPIO_PRT2_INTR
.set Pin_1__INTR_CFG, CYREG_GPIO_PRT2_INTR_CFG
.set Pin_1__INTSTAT, CYREG_GPIO_PRT2_INTR
.set Pin_1__MASK, 0x01
.set Pin_1__PA__CFG0, CYREG_UDB_PA2_CFG0
.set Pin_1__PA__CFG1, CYREG_UDB_PA2_CFG1
.set Pin_1__PA__CFG10, CYREG_UDB_PA2_CFG10
.set Pin_1__PA__CFG11, CYREG_UDB_PA2_CFG11
.set Pin_1__PA__CFG12, CYREG_UDB_PA2_CFG12
.set Pin_1__PA__CFG13, CYREG_UDB_PA2_CFG13
.set Pin_1__PA__CFG14, CYREG_UDB_PA2_CFG14
.set Pin_1__PA__CFG2, CYREG_UDB_PA2_CFG2
.set Pin_1__PA__CFG3, CYREG_UDB_PA2_CFG3
.set Pin_1__PA__CFG4, CYREG_UDB_PA2_CFG4
.set Pin_1__PA__CFG5, CYREG_UDB_PA2_CFG5
.set Pin_1__PA__CFG6, CYREG_UDB_PA2_CFG6
.set Pin_1__PA__CFG7, CYREG_UDB_PA2_CFG7
.set Pin_1__PA__CFG8, CYREG_UDB_PA2_CFG8
.set Pin_1__PA__CFG9, CYREG_UDB_PA2_CFG9
.set Pin_1__PC, CYREG_GPIO_PRT2_PC
.set Pin_1__PC2, CYREG_GPIO_PRT2_PC2
.set Pin_1__PORT, 2
.set Pin_1__PS, CYREG_GPIO_PRT2_PS
.set Pin_1__SHIFT, 0

/* UART_1_rx */
.set UART_1_rx__0__DR, CYREG_GPIO_PRT0_DR
.set UART_1_rx__0__DR_CLR, CYREG_GPIO_PRT0_DR_CLR
.set UART_1_rx__0__DR_INV, CYREG_GPIO_PRT0_DR_INV
.set UART_1_rx__0__DR_SET, CYREG_GPIO_PRT0_DR_SET
.set UART_1_rx__0__HSIOM, CYREG_HSIOM_PORT_SEL0
.set UART_1_rx__0__HSIOM_MASK, 0x000F0000
.set UART_1_rx__0__HSIOM_SHIFT, 16
.set UART_1_rx__0__INTCFG, CYREG_GPIO_PRT0_INTR_CFG
.set UART_1_rx__0__INTR, CYREG_GPIO_PRT0_INTR
.set UART_1_rx__0__INTR_CFG, CYREG_GPIO_PRT0_INTR_CFG
.set UART_1_rx__0__INTSTAT, CYREG_GPIO_PRT0_INTR
.set UART_1_rx__0__MASK, 0x10
.set UART_1_rx__0__PA__CFG0, CYREG_UDB_PA0_CFG0
.set UART_1_rx__0__PA__CFG1, CYREG_UDB_PA0_CFG1
.set UART_1_rx__0__PA__CFG10, CYREG_UDB_PA0_CFG10
.set UART_1_rx__0__PA__CFG11, CYREG_UDB_PA0_CFG11
.set UART_1_rx__0__PA__CFG12, CYREG_UDB_PA0_CFG12
.set UART_1_rx__0__PA__CFG13, CYREG_UDB_PA0_CFG13
.set UART_1_rx__0__PA__CFG14, CYREG_UDB_PA0_CFG14
.set UART_1_rx__0__PA__CFG2, CYREG_UDB_PA0_CFG2
.set UART_1_rx__0__PA__CFG3, CYREG_UDB_PA0_CFG3
.set UART_1_rx__0__PA__CFG4, CYREG_UDB_PA0_CFG4
.set UART_1_rx__0__PA__CFG5, CYREG_UDB_PA0_CFG5
.set UART_1_rx__0__PA__CFG6, CYREG_UDB_PA0_CFG6
.set UART_1_rx__0__PA__CFG7, CYREG_UDB_PA0_CFG7
.set UART_1_rx__0__PA__CFG8, CYREG_UDB_PA0_CFG8
.set UART_1_rx__0__PA__CFG9, CYREG_UDB_PA0_CFG9
.set UART_1_rx__0__PC, CYREG_GPIO_PRT0_PC
.set UART_1_rx__0__PC2, CYREG_GPIO_PRT0_PC2
.set UART_1_rx__0__PORT, 0
.set UART_1_rx__0__PS, CYREG_GPIO_PRT0_PS
.set UART_1_rx__0__SHIFT, 4
.set UART_1_rx__DR, CYREG_GPIO_PRT0_DR
.set UART_1_rx__DR_CLR, CYREG_GPIO_PRT0_DR_CLR
.set UART_1_rx__DR_INV, CYREG_GPIO_PRT0_DR_INV
.set UART_1_rx__DR_SET, CYREG_GPIO_PRT0_DR_SET
.set UART_1_rx__INTCFG, CYREG_GPIO_PRT0_INTR_CFG
.set UART_1_rx__INTR, CYREG_GPIO_PRT0_INTR
.set UART_1_rx__INTR_CFG, CYREG_GPIO_PRT0_INTR_CFG
.set UART_1_rx__INTSTAT, CYREG_GPIO_PRT0_INTR
.set UART_1_rx__MASK, 0x10
.set UART_1_rx__PA__CFG0, CYREG_UDB_PA0_CFG0
.set UART_1_rx__PA__CFG1, CYREG_UDB_PA0_CFG1
.set UART_1_rx__PA__CFG10, CYREG_UDB_PA0_CFG10
.set UART_1_rx__PA__CFG11, CYREG_UDB_PA0_CFG11
.set UART_1_rx__PA__CFG12, CYREG_UDB_PA0_CFG12
.set UART_1_rx__PA__CFG13, CYREG_UDB_PA0_CFG13
.set UART_1_rx__PA__CFG14, CYREG_UDB_PA0_CFG14
.set UART_1_rx__PA__CFG2, CYREG_UDB_PA0_CFG2
.set UART_1_rx__PA__CFG3, CYREG_UDB_PA0_CFG3
.set UART_1_rx__PA__CFG4, CYREG_UDB_PA0_CFG4
.set UART_1_rx__PA__CFG5, CYREG_UDB_PA0_CFG5
.set UART_1_rx__PA__CFG6, CYREG_UDB_PA0_CFG6
.set UART_1_rx__PA__CFG7, CYREG_UDB_PA0_CFG7
.set UART_1_rx__PA__CFG8, CYREG_UDB_PA0_CFG8
.set UART_1_rx__PA__CFG9, CYREG_UDB_PA0_CFG9
.set UART_1_rx__PC, CYREG_GPIO_PRT0_PC
.set UART_1_rx__PC2, CYREG_GPIO_PRT0_PC2
.set UART_1_rx__PORT, 0
.set UART_1_rx__PS, CYREG_GPIO_PRT0_PS
.set UART_1_rx__SHIFT, 4

/* UART_1_SCB */
.set UART_1_SCB__CTRL, CYREG_SCB0_CTRL
.set UART_1_SCB__EZ_DATA0, CYREG_SCB0_EZ_DATA0
.set UART_1_SCB__EZ_DATA1, CYREG_SCB0_EZ_DATA1
.set UART_1_SCB__EZ_DATA10, CYREG_SCB0_EZ_DATA10
.set UART_1_SCB__EZ_DATA11, CYREG_SCB0_EZ_DATA11
.set UART_1_SCB__EZ_DATA12, CYREG_SCB0_EZ_DATA12
.set UART_1_SCB__EZ_DATA13, CYREG_SCB0_EZ_DATA13
.set UART_1_SCB__EZ_DATA14, CYREG_SCB0_EZ_DATA14
.set UART_1_SCB__EZ_DATA15, CYREG_SCB0_EZ_DATA15
.set UART_1_SCB__EZ_DATA16, CYREG_SCB0_EZ_DATA16
.set UART_1_SCB__EZ_DATA17, CYREG_SCB0_EZ_DATA17
.set UART_1_SCB__EZ_DATA18, CYREG_SCB0_EZ_DATA18
.set UART_1_SCB__EZ_DATA19, CYREG_SCB0_EZ_DATA19
.set UART_1_SCB__EZ_DATA2, CYREG_SCB0_EZ_DATA2
.set UART_1_SCB__EZ_DATA20, CYREG_SCB0_EZ_DATA20
.set UART_1_SCB__EZ_DATA21, CYREG_SCB0_EZ_DATA21
.set UART_1_SCB__EZ_DATA22, CYREG_SCB0_EZ_DATA22
.set UART_1_SCB__EZ_DATA23, CYREG_SCB0_EZ_DATA23
.set UART_1_SCB__EZ_DATA24, CYREG_SCB0_EZ_DATA24
.set UART_1_SCB__EZ_DATA25, CYREG_SCB0_EZ_DATA25
.set UART_1_SCB__EZ_DATA26, CYREG_SCB0_EZ_DATA26
.set UART_1_SCB__EZ_DATA27, CYREG_SCB0_EZ_DATA27
.set UART_1_SCB__EZ_DATA28, CYREG_SCB0_EZ_DATA28
.set UART_1_SCB__EZ_DATA29, CYREG_SCB0_EZ_DATA29
.set UART_1_SCB__EZ_DATA3, CYREG_SCB0_EZ_DATA3
.set UART_1_SCB__EZ_DATA30, CYREG_SCB0_EZ_DATA30
.set UART_1_SCB__EZ_DATA31, CYREG_SCB0_EZ_DATA31
.set UART_1_SCB__EZ_DATA4, CYREG_SCB0_EZ_DATA4
.set UART_1_SCB__EZ_DATA5, CYREG_SCB0_EZ_DATA5
.set UART_1_SCB__EZ_DATA6, CYREG_SCB0_EZ_DATA6
.set UART_1_SCB__EZ_DATA7, CYREG_SCB0_EZ_DATA7
.set UART_1_SCB__EZ_DATA8, CYREG_SCB0_EZ_DATA8
.set UART_1_SCB__EZ_DATA9, CYREG_SCB0_EZ_DATA9
.set UART_1_SCB__I2C_CFG, CYREG_SCB0_I2C_CFG
.set UART_1_SCB__I2C_CTRL, CYREG_SCB0_I2C_CTRL
.set UART_1_SCB__I2C_M_CMD, CYREG_SCB0_I2C_M_CMD
.set UART_1_SCB__I2C_S_CMD, CYREG_SCB0_I2C_S_CMD
.set UART_1_SCB__I2C_STATUS, CYREG_SCB0_I2C_STATUS
.set UART_1_SCB__INTR_CAUSE, CYREG_SCB0_INTR_CAUSE
.set UART_1_SCB__INTR_I2C_EC, CYREG_SCB0_INTR_I2C_EC
.set UART_1_SCB__INTR_I2C_EC_MASK, CYREG_SCB0_INTR_I2C_EC_MASK
.set UART_1_SCB__INTR_I2C_EC_MASKED, CYREG_SCB0_INTR_I2C_EC_MASKED
.set UART_1_SCB__INTR_M, CYREG_SCB0_INTR_M
.set UART_1_SCB__INTR_M_MASK, CYREG_SCB0_INTR_M_MASK
.set UART_1_SCB__INTR_M_MASKED, CYREG_SCB0_INTR_M_MASKED
.set UART_1_SCB__INTR_M_SET, CYREG_SCB0_INTR_M_SET
.set UART_1_SCB__INTR_RX, CYREG_SCB0_INTR_RX
.set UART_1_SCB__INTR_RX_MASK, CYREG_SCB0_INTR_RX_MASK
.set UART_1_SCB__INTR_RX_MASKED, CYREG_SCB0_INTR_RX_MASKED
.set UART_1_SCB__INTR_RX_SET, CYREG_SCB0_INTR_RX_SET
.set UART_1_SCB__INTR_S, CYREG_SCB0_INTR_S
.set UART_1_SCB__INTR_S_MASK, CYREG_SCB0_INTR_S_MASK
.set UART_1_SCB__INTR_S_MASKED, CYREG_SCB0_INTR_S_MASKED
.set UART_1_SCB__INTR_S_SET, CYREG_SCB0_INTR_S_SET
.set UART_1_SCB__INTR_SPI_EC, CYREG_SCB0_INTR_SPI_EC
.set UART_1_SCB__INTR_SPI_EC_MASK, CYREG_SCB0_INTR_SPI_EC_MASK
.set UART_1_SCB__INTR_SPI_EC_MASKED, CYREG_SCB0_INTR_SPI_EC_MASKED
.set UART_1_SCB__INTR_TX, CYREG_SCB0_INTR_TX
.set UART_1_SCB__INTR_TX_MASK, CYREG_SCB0_INTR_TX_MASK
.set UART_1_SCB__INTR_TX_MASKED, CYREG_SCB0_INTR_TX_MASKED
.set UART_1_SCB__INTR_TX_SET, CYREG_SCB0_INTR_TX_SET
.set UART_1_SCB__RX_CTRL, CYREG_SCB0_RX_CTRL
.set UART_1_SCB__RX_FIFO_CTRL, CYREG_SCB0_RX_FIFO_CTRL
.set UART_1_SCB__RX_FIFO_RD, CYREG_SCB0_RX_FIFO_RD
.set UART_1_SCB__RX_FIFO_RD_SILENT, CYREG_SCB0_RX_FIFO_RD_SILENT
.set UART_1_SCB__RX_FIFO_STATUS, CYREG_SCB0_RX_FIFO_STATUS
.set UART_1_SCB__RX_MATCH, CYREG_SCB0_RX_MATCH
.set UART_1_SCB__SPI_CTRL, CYREG_SCB0_SPI_CTRL
.set UART_1_SCB__SPI_STATUS, CYREG_SCB0_SPI_STATUS
.set UART_1_SCB__SS0_POSISTION, 0
.set UART_1_SCB__SS1_POSISTION, 1
.set UART_1_SCB__SS2_POSISTION, 2
.set UART_1_SCB__SS3_POSISTION, 3
.set UART_1_SCB__STATUS, CYREG_SCB0_STATUS
.set UART_1_SCB__TX_CTRL, CYREG_SCB0_TX_CTRL
.set UART_1_SCB__TX_FIFO_CTRL, CYREG_SCB0_TX_FIFO_CTRL
.set UART_1_SCB__TX_FIFO_STATUS, CYREG_SCB0_TX_FIFO_STATUS
.set UART_1_SCB__TX_FIFO_WR, CYREG_SCB0_TX_FIFO_WR
.set UART_1_SCB__UART_CTRL, CYREG_SCB0_UART_CTRL
.set UART_1_SCB__UART_FLOW_CTRL, CYREG_SCB0_UART_FLOW_CTRL
.set UART_1_SCB__UART_RX_CTRL, CYREG_SCB0_UART_RX_CTRL
.set UART_1_SCB__UART_RX_STATUS, CYREG_SCB0_UART_RX_STATUS
.set UART_1_SCB__UART_TX_CTRL, CYREG_SCB0_UART_TX_CTRL

/* UART_1_SCBCLK */
.set UART_1_SCBCLK__CTRL_REGISTER, CYREG_PERI_PCLK_CTL1
.set UART_1_SCBCLK__DIV_ID, 0x00000042
.set UART_1_SCBCLK__DIV_REGISTER, CYREG_PERI_DIV_16_CTL2
.set UART_1_SCBCLK__PA_DIV_ID, 0x000000FF

/* UART_1_tx */
.set UART_1_tx__0__DR, CYREG_GPIO_PRT0_DR
.set UART_1_tx__0__DR_CLR, CYREG_GPIO_PRT0_DR_CLR
.set UART_1_tx__0__DR_INV, CYREG_GPIO_PRT0_DR_INV
.set UART_1_tx__0__DR_SET, CYREG_GPIO_PRT0_DR_SET
.set UART_1_tx__0__HSIOM, CYREG_HSIOM_PORT_SEL0
.set UART_1_tx__0__HSIOM_MASK, 0x00F00000
.set UART_1_tx__0__HSIOM_SHIFT, 20
.set UART_1_tx__0__INTCFG, CYREG_GPIO_PRT0_INTR_CFG
.set UART_1_tx__0__INTR, CYREG_GPIO_PRT0_INTR
.set UART_1_tx__0__INTR_CFG, CYREG_GPIO_PRT0_INTR_CFG
.set UART_1_tx__0__INTSTAT, CYREG_GPIO_PRT0_INTR
.set UART_1_tx__0__MASK, 0x20
.set UART_1_tx__0__OUT_SEL, CYREG_UDB_PA0_CFG10
.set UART_1_tx__0__OUT_SEL_SHIFT, 10
.set UART_1_tx__0__OUT_SEL_VAL, -1
.set UART_1_tx__0__PA__CFG0, CYREG_UDB_PA0_CFG0
.set UART_1_tx__0__PA__CFG1, CYREG_UDB_PA0_CFG1
.set UART_1_tx__0__PA__CFG10, CYREG_UDB_PA0_CFG10
.set UART_1_tx__0__PA__CFG11, CYREG_UDB_PA0_CFG11
.set UART_1_tx__0__PA__CFG12, CYREG_UDB_PA0_CFG12
.set UART_1_tx__0__PA__CFG13, CYREG_UDB_PA0_CFG13
.set UART_1_tx__0__PA__CFG14, CYREG_UDB_PA0_CFG14
.set UART_1_tx__0__PA__CFG2, CYREG_UDB_PA0_CFG2
.set UART_1_tx__0__PA__CFG3, CYREG_UDB_PA0_CFG3
.set UART_1_tx__0__PA__CFG4, CYREG_UDB_PA0_CFG4
.set UART_1_tx__0__PA__CFG5, CYREG_UDB_PA0_CFG5
.set UART_1_tx__0__PA__CFG6, CYREG_UDB_PA0_CFG6
.set UART_1_tx__0__PA__CFG7, CYREG_UDB_PA0_CFG7
.set UART_1_tx__0__PA__CFG8, CYREG_UDB_PA0_CFG8
.set UART_1_tx__0__PA__CFG9, CYREG_UDB_PA0_CFG9
.set UART_1_tx__0__PC, CYREG_GPIO_PRT0_PC
.set UART_1_tx__0__PC2, CYREG_GPIO_PRT0_PC2
.set UART_1_tx__0__PORT, 0
.set UART_1_tx__0__PS, CYREG_GPIO_PRT0_PS
.set UART_1_tx__0__SHIFT, 5
.set UART_1_tx__DR, CYREG_GPIO_PRT0_DR
.set UART_1_tx__DR_CLR, CYREG_GPIO_PRT0_DR_CLR
.set UART_1_tx__DR_INV, CYREG_GPIO_PRT0_DR_INV
.set UART_1_tx__DR_SET, CYREG_GPIO_PRT0_DR_SET
.set UART_1_tx__INTCFG, CYREG_GPIO_PRT0_INTR_CFG
.set UART_1_tx__INTR, CYREG_GPIO_PRT0_INTR
.set UART_1_tx__INTR_CFG, CYREG_GPIO_PRT0_INTR_CFG
.set UART_1_tx__INTSTAT, CYREG_GPIO_PRT0_INTR
.set UART_1_tx__MASK, 0x20
.set UART_1_tx__PA__CFG0, CYREG_UDB_PA0_CFG0
.set UART_1_tx__PA__CFG1, CYREG_UDB_PA0_CFG1
.set UART_1_tx__PA__CFG10, CYREG_UDB_PA0_CFG10
.set UART_1_tx__PA__CFG11, CYREG_UDB_PA0_CFG11
.set UART_1_tx__PA__CFG12, CYREG_UDB_PA0_CFG12
.set UART_1_tx__PA__CFG13, CYREG_UDB_PA0_CFG13
.set UART_1_tx__PA__CFG14, CYREG_UDB_PA0_CFG14
.set UART_1_tx__PA__CFG2, CYREG_UDB_PA0_CFG2
.set UART_1_tx__PA__CFG3, CYREG_UDB_PA0_CFG3
.set UART_1_tx__PA__CFG4, CYREG_UDB_PA0_CFG4
.set UART_1_tx__PA__CFG5, CYREG_UDB_PA0_CFG5
.set UART_1_tx__PA__CFG6, CYREG_UDB_PA0_CFG6
.set UART_1_tx__PA__CFG7, CYREG_UDB_PA0_CFG7
.set UART_1_tx__PA__CFG8, CYREG_UDB_PA0_CFG8
.set UART_1_tx__PA__CFG9, CYREG_UDB_PA0_CFG9
.set UART_1_tx__PC, CYREG_GPIO_PRT0_PC
.set UART_1_tx__PC2, CYREG_GPIO_PRT0_PC2
.set UART_1_tx__PORT, 0
.set UART_1_tx__PS, CYREG_GPIO_PRT0_PS
.set UART_1_tx__SHIFT, 5

/* Clock_1 */
.set Clock_1__CTRL_REGISTER, CYREG_PERI_PCLK_CTL7
.set Clock_1__DIV_ID, 0x00000040
.set Clock_1__DIV_REGISTER, CYREG_PERI_DIV_16_CTL0
.set Clock_1__PA_DIV_ID, 0x000000FF

/* Pin_Red */
.set Pin_Red__0__DR, CYREG_GPIO_PRT3_DR
.set Pin_Red__0__DR_CLR, CYREG_GPIO_PRT3_DR_CLR
.set Pin_Red__0__DR_INV, CYREG_GPIO_PRT3_DR_INV
.set Pin_Red__0__DR_SET, CYREG_GPIO_PRT3_DR_SET
.set Pin_Red__0__HSIOM, CYREG_HSIOM_PORT_SEL3
.set Pin_Red__0__HSIOM_MASK, 0xF0000000
.set Pin_Red__0__HSIOM_SHIFT, 28
.set Pin_Red__0__INTCFG, CYREG_GPIO_PRT3_INTR_CFG
.set Pin_Red__0__INTR, CYREG_GPIO_PRT3_INTR
.set Pin_Red__0__INTR_CFG, CYREG_GPIO_PRT3_INTR_CFG
.set Pin_Red__0__INTSTAT, CYREG_GPIO_PRT3_INTR
.set Pin_Red__0__MASK, 0x80
.set Pin_Red__0__OUT_SEL, CYREG_UDB_PA3_CFG10
.set Pin_Red__0__OUT_SEL_SHIFT, 14
.set Pin_Red__0__OUT_SEL_VAL, 3
.set Pin_Red__0__PA__CFG0, CYREG_UDB_PA3_CFG0
.set Pin_Red__0__PA__CFG1, CYREG_UDB_PA3_CFG1
.set Pin_Red__0__PA__CFG10, CYREG_UDB_PA3_CFG10
.set Pin_Red__0__PA__CFG11, CYREG_UDB_PA3_CFG11
.set Pin_Red__0__PA__CFG12, CYREG_UDB_PA3_CFG12
.set Pin_Red__0__PA__CFG13, CYREG_UDB_PA3_CFG13
.set Pin_Red__0__PA__CFG14, CYREG_UDB_PA3_CFG14
.set Pin_Red__0__PA__CFG2, CYREG_UDB_PA3_CFG2
.set Pin_Red__0__PA__CFG3, CYREG_UDB_PA3_CFG3
.set Pin_Red__0__PA__CFG4, CYREG_UDB_PA3_CFG4
.set Pin_Red__0__PA__CFG5, CYREG_UDB_PA3_CFG5
.set Pin_Red__0__PA__CFG6, CYREG_UDB_PA3_CFG6
.set Pin_Red__0__PA__CFG7, CYREG_UDB_PA3_CFG7
.set Pin_Red__0__PA__CFG8, CYREG_UDB_PA3_CFG8
.set Pin_Red__0__PA__CFG9, CYREG_UDB_PA3_CFG9
.set Pin_Red__0__PC, CYREG_GPIO_PRT3_PC
.set Pin_Red__0__PC2, CYREG_GPIO_PRT3_PC2
.set Pin_Red__0__PORT, 3
.set Pin_Red__0__PS, CYREG_GPIO_PRT3_PS
.set Pin_Red__0__SHIFT, 7
.set Pin_Red__DR, CYREG_GPIO_PRT3_DR
.set Pin_Red__DR_CLR, CYREG_GPIO_PRT3_DR_CLR
.set Pin_Red__DR_INV, CYREG_GPIO_PRT3_DR_INV
.set Pin_Red__DR_SET, CYREG_GPIO_PRT3_DR_SET
.set Pin_Red__INTCFG, CYREG_GPIO_PRT3_INTR_CFG
.set Pin_Red__INTR, CYREG_GPIO_PRT3_INTR
.set Pin_Red__INTR_CFG, CYREG_GPIO_PRT3_INTR_CFG
.set Pin_Red__INTSTAT, CYREG_GPIO_PRT3_INTR
.set Pin_Red__MASK, 0x80
.set Pin_Red__PA__CFG0, CYREG_UDB_PA3_CFG0
.set Pin_Red__PA__CFG1, CYREG_UDB_PA3_CFG1
.set Pin_Red__PA__CFG10, CYREG_UDB_PA3_CFG10
.set Pin_Red__PA__CFG11, CYREG_UDB_PA3_CFG11
.set Pin_Red__PA__CFG12, CYREG_UDB_PA3_CFG12
.set Pin_Red__PA__CFG13, CYREG_UDB_PA3_CFG13
.set Pin_Red__PA__CFG14, CYREG_UDB_PA3_CFG14
.set Pin_Red__PA__CFG2, CYREG_UDB_PA3_CFG2
.set Pin_Red__PA__CFG3, CYREG_UDB_PA3_CFG3
.set Pin_Red__PA__CFG4, CYREG_UDB_PA3_CFG4
.set Pin_Red__PA__CFG5, CYREG_UDB_PA3_CFG5
.set Pin_Red__PA__CFG6, CYREG_UDB_PA3_CFG6
.set Pin_Red__PA__CFG7, CYREG_UDB_PA3_CFG7
.set Pin_Red__PA__CFG8, CYREG_UDB_PA3_CFG8
.set Pin_Red__PA__CFG9, CYREG_UDB_PA3_CFG9
.set Pin_Red__PC, CYREG_GPIO_PRT3_PC
.set Pin_Red__PC2, CYREG_GPIO_PRT3_PC2
.set Pin_Red__PORT, 3
.set Pin_Red__PS, CYREG_GPIO_PRT3_PS
.set Pin_Red__SHIFT, 7

/* ADC_SAR_Seq_1_cy_psoc4_sar */
.set ADC_SAR_Seq_1_cy_psoc4_sar__SAR_CTRL, CYREG_SAR_CTRL
.set ADC_SAR_Seq_1_cy_psoc4_sar__SAR_INTR, CYREG_SAR_INTR
.set ADC_SAR_Seq_1_cy_psoc4_sar__SAR_INTR_CAUSE, CYREG_SAR_INTR_CAUSE
.set ADC_SAR_Seq_1_cy_psoc4_sar__SAR_INTR_MASK, CYREG_SAR_INTR_MASK
.set ADC_SAR_Seq_1_cy_psoc4_sar__SAR_INTR_MASKED, CYREG_SAR_INTR_MASKED
.set ADC_SAR_Seq_1_cy_psoc4_sar__SAR_INTR_SET, CYREG_SAR_INTR_SET
.set ADC_SAR_Seq_1_cy_psoc4_sar__SAR_NUMBER, 0
.set ADC_SAR_Seq_1_cy_psoc4_sar__SAR_RANGE_COND, CYREG_SAR_RANGE_COND
.set ADC_SAR_Seq_1_cy_psoc4_sar__SAR_RANGE_INTR_MASK, CYREG_SAR_RANGE_INTR_MASK
.set ADC_SAR_Seq_1_cy_psoc4_sar__SAR_RANGE_INTR_MASKED, CYREG_SAR_RANGE_INTR_MASKED
.set ADC_SAR_Seq_1_cy_psoc4_sar__SAR_RANGE_INTR_SET, CYREG_SAR_RANGE_INTR_SET
.set ADC_SAR_Seq_1_cy_psoc4_sar__SAR_RANGE_THRES, CYREG_SAR_RANGE_THRES
.set ADC_SAR_Seq_1_cy_psoc4_sar__SAR_SAMPLE_CTRL, CYREG_SAR_SAMPLE_CTRL
.set ADC_SAR_Seq_1_cy_psoc4_sar__SAR_SAMPLE_TIME01, CYREG_SAR_SAMPLE_TIME01
.set ADC_SAR_Seq_1_cy_psoc4_sar__SAR_SAMPLE_TIME23, CYREG_SAR_SAMPLE_TIME23
.set ADC_SAR_Seq_1_cy_psoc4_sar__SAR_SATURATE_INTR_MASK, CYREG_SAR_SATURATE_INTR_MASK
.set ADC_SAR_Seq_1_cy_psoc4_sar__SAR_SATURATE_INTR_MASKED, CYREG_SAR_SATURATE_INTR_MASKED
.set ADC_SAR_Seq_1_cy_psoc4_sar__SAR_SATURATE_INTR_SET, CYREG_SAR_SATURATE_INTR_SET
.set ADC_SAR_Seq_1_cy_psoc4_sar__SAR_STATUS, CYREG_SAR_STATUS

/* ADC_SAR_Seq_1_intClock */
.set ADC_SAR_Seq_1_intClock__CTRL_REGISTER, CYREG_PERI_PCLK_CTL6
.set ADC_SAR_Seq_1_intClock__DIV_ID, 0x00000041
.set ADC_SAR_Seq_1_intClock__DIV_REGISTER, CYREG_PERI_DIV_16_CTL1
.set ADC_SAR_Seq_1_intClock__PA_DIV_ID, 0x000000FF

/* ADC_SAR_Seq_1_IRQ */
.set ADC_SAR_Seq_1_IRQ__INTC_CLR_EN_REG, CYREG_CM0_ICER
.set ADC_SAR_Seq_1_IRQ__INTC_CLR_PD_REG, CYREG_CM0_ICPR
.set ADC_SAR_Seq_1_IRQ__INTC_MASK, 0x8000
.set ADC_SAR_Seq_1_IRQ__INTC_NUMBER, 15
.set ADC_SAR_Seq_1_IRQ__INTC_PRIOR_MASK, 0xC0000000
.set ADC_SAR_Seq_1_IRQ__INTC_PRIOR_NUM, 3
.set ADC_SAR_Seq_1_IRQ__INTC_PRIOR_REG, CYREG_CM0_IPR3
.set ADC_SAR_Seq_1_IRQ__INTC_SET_EN_REG, CYREG_CM0_ISER
.set ADC_SAR_Seq_1_IRQ__INTC_SET_PD_REG, CYREG_CM0_ISPR

/* Miscellaneous */
.set CYDEV_BCLK__HFCLK__HZ, 48000000
.set CYDEV_BCLK__HFCLK__KHZ, 48000
.set CYDEV_BCLK__HFCLK__MHZ, 48
.set CYDEV_BCLK__SYSCLK__HZ, 48000000
.set CYDEV_BCLK__SYSCLK__KHZ, 48000
.set CYDEV_BCLK__SYSCLK__MHZ, 48
.set CYDEV_CHIP_DIE_GEN4, 2
.set CYDEV_CHIP_DIE_LEOPARD, 1
.set CYDEV_CHIP_DIE_PANTHER, 13
.set CYDEV_CHIP_DIE_PSOC4A, 6
.set CYDEV_CHIP_DIE_PSOC5LP, 12
.set CYDEV_CHIP_DIE_UNKNOWN, 0
.set CYDEV_CHIP_FAMILY_PSOC3, 1
.set CYDEV_CHIP_FAMILY_PSOC4, 2
.set CYDEV_CHIP_FAMILY_PSOC5, 3
.set CYDEV_CHIP_FAMILY_UNKNOWN, 0
.set CYDEV_CHIP_FAMILY_USED, CYDEV_CHIP_FAMILY_PSOC4
.set CYDEV_CHIP_JTAG_ID, 0x0E34119E
.set CYDEV_CHIP_MEMBER_3A, 1
.set CYDEV_CHIP_MEMBER_4A, 6
.set CYDEV_CHIP_MEMBER_4C, 10
.set CYDEV_CHIP_MEMBER_4D, 3
.set CYDEV_CHIP_MEMBER_4E, 5
.set CYDEV_CHIP_MEMBER_4F, 7
.set CYDEV_CHIP_MEMBER_4G, 2
.set CYDEV_CHIP_MEMBER_4H, 4
.set CYDEV_CHIP_MEMBER_4L, 9
.set CYDEV_CHIP_MEMBER_4M, 8
.set CYDEV_CHIP_MEMBER_5A, 12
.set CYDEV_CHIP_MEMBER_5B, 11
.set CYDEV_CHIP_MEMBER_UNKNOWN, 0
.set CYDEV_CHIP_MEMBER_USED, CYDEV_CHIP_MEMBER_4F
.set CYDEV_CHIP_DIE_EXPECT, CYDEV_CHIP_MEMBER_USED
.set CYDEV_CHIP_DIE_ACTUAL, CYDEV_CHIP_DIE_EXPECT
.set CYDEV_CHIP_REV_GEN4_ES, 17
.set CYDEV_CHIP_REV_GEN4_ES2, 33
.set CYDEV_CHIP_REV_GEN4_PRODUCTION, 17
.set CYDEV_CHIP_REV_LEOPARD_ES1, 0
.set CYDEV_CHIP_REV_LEOPARD_ES2, 1
.set CYDEV_CHIP_REV_LEOPARD_ES3, 3
.set CYDEV_CHIP_REV_LEOPARD_PRODUCTION, 3
.set CYDEV_CHIP_REV_PANTHER_ES0, 0
.set CYDEV_CHIP_REV_PANTHER_ES1, 1
.set CYDEV_CHIP_REV_PANTHER_PRODUCTION, 1
.set CYDEV_CHIP_REV_PSOC4A_ES0, 17
.set CYDEV_CHIP_REV_PSOC4A_PRODUCTION, 17
.set CYDEV_CHIP_REV_PSOC5LP_ES0, 0
.set CYDEV_CHIP_REV_PSOC5LP_PRODUCTION, 0
.set CYDEV_CHIP_REVISION_3A_ES1, 0
.set CYDEV_CHIP_REVISION_3A_ES2, 1
.set CYDEV_CHIP_REVISION_3A_ES3, 3
.set CYDEV_CHIP_REVISION_3A_PRODUCTION, 3
.set CYDEV_CHIP_REVISION_4A_ES0, 17
.set CYDEV_CHIP_REVISION_4A_PRODUCTION, 17
.set CYDEV_CHIP_REVISION_4C_PRODUCTION, 0
.set CYDEV_CHIP_REVISION_4D_PRODUCTION, 0
.set CYDEV_CHIP_REVISION_4E_PRODUCTION, 0
.set CYDEV_CHIP_REVISION_4F_PRODUCTION, 0
.set CYDEV_CHIP_REVISION_4F_PRODUCTION_256K, 0
.set CYDEV_CHIP_REVISION_4G_ES, 17
.set CYDEV_CHIP_REVISION_4G_ES2, 33
.set CYDEV_CHIP_REVISION_4G_PRODUCTION, 17
.set CYDEV_CHIP_REVISION_4H_PRODUCTION, 0
.set CYDEV_CHIP_REVISION_4L_PRODUCTION, 0
.set CYDEV_CHIP_REVISION_4M_PRODUCTION, 0
.set CYDEV_CHIP_REVISION_5A_ES0, 0
.set CYDEV_CHIP_REVISION_5A_ES1, 1
.set CYDEV_CHIP_REVISION_5A_PRODUCTION, 1
.set CYDEV_CHIP_REVISION_5B_ES0, 0
.set CYDEV_CHIP_REVISION_5B_PRODUCTION, 0
.set CYDEV_CHIP_REVISION_USED, CYDEV_CHIP_REVISION_4F_PRODUCTION
.set CYDEV_CHIP_REV_EXPECT, CYDEV_CHIP_REVISION_USED
.set CYDEV_CONFIG_READ_ACCELERATOR, 1
.set CYDEV_CONFIG_UNUSED_IO_AllowButWarn, 0
.set CYDEV_CONFIG_UNUSED_IO, CYDEV_CONFIG_UNUSED_IO_AllowButWarn
.set CYDEV_CONFIG_UNUSED_IO_AllowWithInfo, 1
.set CYDEV_CONFIG_UNUSED_IO_Disallowed, 2
.set CYDEV_CONFIGURATION_COMPRESSED, 1
.set CYDEV_CONFIGURATION_MODE_COMPRESSED, 0
.set CYDEV_CONFIGURATION_MODE, CYDEV_CONFIGURATION_MODE_COMPRESSED
.set CYDEV_CONFIGURATION_MODE_DMA, 2
.set CYDEV_CONFIGURATION_MODE_UNCOMPRESSED, 1
.set CYDEV_DEBUG_PROTECT_KILL, 4
.set CYDEV_DEBUG_PROTECT_OPEN, 1
.set CYDEV_DEBUG_PROTECT, CYDEV_DEBUG_PROTECT_OPEN
.set CYDEV_DEBUG_PROTECT_PROTECTED, 2
.set CYDEV_DEBUGGING_DPS_Disable, 3
.set CYDEV_DEBUGGING_DPS_SWD, 2
.set CYDEV_DEBUGGING_DPS, CYDEV_DEBUGGING_DPS_SWD
.set CYDEV_DEBUGGING_ENABLE, 1
.set CYDEV_DFT_SELECT_CLK0, 10
.set CYDEV_DFT_SELECT_CLK1, 11
.set CYDEV_HEAP_SIZE, 0x80
.set CYDEV_IMO_TRIMMED_BY_WCO, 0
.set CYDEV_PROJ_TYPE, 0
.set CYDEV_PROJ_TYPE_BOOTLOADER, 1
.set CYDEV_PROJ_TYPE_LAUNCHER, 5
.set CYDEV_PROJ_TYPE_LOADABLE, 2
.set CYDEV_PROJ_TYPE_LOADABLEANDBOOTLOADER, 4
.set CYDEV_PROJ_TYPE_MULTIAPPBOOTLOADER, 3
.set CYDEV_PROJ_TYPE_STANDARD, 0
.set CYDEV_STACK_SIZE, 0x0800
.set CYDEV_USE_BUNDLED_CMSIS, 1
.set CYDEV_VARIABLE_VDDA, 1
.set CYDEV_VDDA_MV, 3300
.set CYDEV_VDDD_MV, 3300
.set CYDEV_VDDR_MV, 3300
.set CYDEV_WDT_GENERATE_ISR, 1
.set CYIPBLOCK_m0s8bless_VERSION, 1
.set CYIPBLOCK_m0s8cpussv2_VERSION, 1
.set CYIPBLOCK_m0s8csd_VERSION, 1
.set CYIPBLOCK_m0s8ioss_VERSION, 1
.set CYIPBLOCK_m0s8lcd_VERSION, 2
.set CYIPBLOCK_m0s8lpcomp_VERSION, 2
.set CYIPBLOCK_m0s8peri_VERSION, 1
.set CYIPBLOCK_m0s8scb_VERSION, 2
.set CYIPBLOCK_m0s8srssv2_VERSION, 1
.set CYIPBLOCK_m0s8tcpwm_VERSION, 2
.set CYIPBLOCK_m0s8udbif_VERSION, 1
.set CYIPBLOCK_s8pass4al_VERSION, 1
.set CYDEV_BOOTLOADER_ENABLE, 0
.endif
