    IF :LNOT::DEF:INCLUDED_CYFITTERRV_INC
INCLUDED_CYFITTERRV_INC EQU 1
    GET cydevicerv_trm.inc

; PWM_1_cy_m0s8_tcpwm_1
PWM_1_cy_m0s8_tcpwm_1__CC EQU CYREG_TCPWM_CNT0_CC
PWM_1_cy_m0s8_tcpwm_1__CC_BUFF EQU CYREG_TCPWM_CNT0_CC_BUFF
PWM_1_cy_m0s8_tcpwm_1__COUNTER EQU CYREG_TCPWM_CNT0_COUNTER
PWM_1_cy_m0s8_tcpwm_1__CTRL EQU CYREG_TCPWM_CNT0_CTRL
PWM_1_cy_m0s8_tcpwm_1__INTR EQU CYREG_TCPWM_CNT0_INTR
PWM_1_cy_m0s8_tcpwm_1__INTR_MASK EQU CYREG_TCPWM_CNT0_INTR_MASK
PWM_1_cy_m0s8_tcpwm_1__INTR_MASKED EQU CYREG_TCPWM_CNT0_INTR_MASKED
PWM_1_cy_m0s8_tcpwm_1__INTR_SET EQU CYREG_TCPWM_CNT0_INTR_SET
PWM_1_cy_m0s8_tcpwm_1__PERIOD EQU CYREG_TCPWM_CNT0_PERIOD
PWM_1_cy_m0s8_tcpwm_1__PERIOD_BUFF EQU CYREG_TCPWM_CNT0_PERIOD_BUFF
PWM_1_cy_m0s8_tcpwm_1__STATUS EQU CYREG_TCPWM_CNT0_STATUS
PWM_1_cy_m0s8_tcpwm_1__TCPWM_CMD EQU CYREG_TCPWM_CMD
PWM_1_cy_m0s8_tcpwm_1__TCPWM_CMDCAPTURE_MASK EQU 0x01
PWM_1_cy_m0s8_tcpwm_1__TCPWM_CMDCAPTURE_SHIFT EQU 0
PWM_1_cy_m0s8_tcpwm_1__TCPWM_CMDRELOAD_MASK EQU 0x100
PWM_1_cy_m0s8_tcpwm_1__TCPWM_CMDRELOAD_SHIFT EQU 8
PWM_1_cy_m0s8_tcpwm_1__TCPWM_CMDSTART_MASK EQU 0x1000000
PWM_1_cy_m0s8_tcpwm_1__TCPWM_CMDSTART_SHIFT EQU 24
PWM_1_cy_m0s8_tcpwm_1__TCPWM_CMDSTOP_MASK EQU 0x10000
PWM_1_cy_m0s8_tcpwm_1__TCPWM_CMDSTOP_SHIFT EQU 16
PWM_1_cy_m0s8_tcpwm_1__TCPWM_CTRL EQU CYREG_TCPWM_CTRL
PWM_1_cy_m0s8_tcpwm_1__TCPWM_CTRL_MASK EQU 0x01
PWM_1_cy_m0s8_tcpwm_1__TCPWM_CTRL_SHIFT EQU 0
PWM_1_cy_m0s8_tcpwm_1__TCPWM_INTR_CAUSE EQU CYREG_TCPWM_INTR_CAUSE
PWM_1_cy_m0s8_tcpwm_1__TCPWM_INTR_CAUSE_MASK EQU 0x01
PWM_1_cy_m0s8_tcpwm_1__TCPWM_INTR_CAUSE_SHIFT EQU 0
PWM_1_cy_m0s8_tcpwm_1__TCPWM_NUMBER EQU 0
PWM_1_cy_m0s8_tcpwm_1__TR_CTRL0 EQU CYREG_TCPWM_CNT0_TR_CTRL0
PWM_1_cy_m0s8_tcpwm_1__TR_CTRL1 EQU CYREG_TCPWM_CNT0_TR_CTRL1
PWM_1_cy_m0s8_tcpwm_1__TR_CTRL2 EQU CYREG_TCPWM_CNT0_TR_CTRL2

; Pin_1
Pin_1__0__DR EQU CYREG_GPIO_PRT2_DR
Pin_1__0__DR_CLR EQU CYREG_GPIO_PRT2_DR_CLR
Pin_1__0__DR_INV EQU CYREG_GPIO_PRT2_DR_INV
Pin_1__0__DR_SET EQU CYREG_GPIO_PRT2_DR_SET
Pin_1__0__HSIOM EQU CYREG_HSIOM_PORT_SEL2
Pin_1__0__HSIOM_MASK EQU 0x0000000F
Pin_1__0__HSIOM_SHIFT EQU 0
Pin_1__0__INTCFG EQU CYREG_GPIO_PRT2_INTR_CFG
Pin_1__0__INTR EQU CYREG_GPIO_PRT2_INTR
Pin_1__0__INTR_CFG EQU CYREG_GPIO_PRT2_INTR_CFG
Pin_1__0__INTSTAT EQU CYREG_GPIO_PRT2_INTR
Pin_1__0__MASK EQU 0x01
Pin_1__0__OUT_SEL EQU CYREG_UDB_PA2_CFG10
Pin_1__0__OUT_SEL_SHIFT EQU 0
Pin_1__0__OUT_SEL_VAL EQU 0
Pin_1__0__PA__CFG0 EQU CYREG_UDB_PA2_CFG0
Pin_1__0__PA__CFG1 EQU CYREG_UDB_PA2_CFG1
Pin_1__0__PA__CFG10 EQU CYREG_UDB_PA2_CFG10
Pin_1__0__PA__CFG11 EQU CYREG_UDB_PA2_CFG11
Pin_1__0__PA__CFG12 EQU CYREG_UDB_PA2_CFG12
Pin_1__0__PA__CFG13 EQU CYREG_UDB_PA2_CFG13
Pin_1__0__PA__CFG14 EQU CYREG_UDB_PA2_CFG14
Pin_1__0__PA__CFG2 EQU CYREG_UDB_PA2_CFG2
Pin_1__0__PA__CFG3 EQU CYREG_UDB_PA2_CFG3
Pin_1__0__PA__CFG4 EQU CYREG_UDB_PA2_CFG4
Pin_1__0__PA__CFG5 EQU CYREG_UDB_PA2_CFG5
Pin_1__0__PA__CFG6 EQU CYREG_UDB_PA2_CFG6
Pin_1__0__PA__CFG7 EQU CYREG_UDB_PA2_CFG7
Pin_1__0__PA__CFG8 EQU CYREG_UDB_PA2_CFG8
Pin_1__0__PA__CFG9 EQU CYREG_UDB_PA2_CFG9
Pin_1__0__PC EQU CYREG_GPIO_PRT2_PC
Pin_1__0__PC2 EQU CYREG_GPIO_PRT2_PC2
Pin_1__0__PORT EQU 2
Pin_1__0__PS EQU CYREG_GPIO_PRT2_PS
Pin_1__0__SHIFT EQU 0
Pin_1__DR EQU CYREG_GPIO_PRT2_DR
Pin_1__DR_CLR EQU CYREG_GPIO_PRT2_DR_CLR
Pin_1__DR_INV EQU CYREG_GPIO_PRT2_DR_INV
Pin_1__DR_SET EQU CYREG_GPIO_PRT2_DR_SET
Pin_1__INTCFG EQU CYREG_GPIO_PRT2_INTR_CFG
Pin_1__INTR EQU CYREG_GPIO_PRT2_INTR
Pin_1__INTR_CFG EQU CYREG_GPIO_PRT2_INTR_CFG
Pin_1__INTSTAT EQU CYREG_GPIO_PRT2_INTR
Pin_1__MASK EQU 0x01
Pin_1__PA__CFG0 EQU CYREG_UDB_PA2_CFG0
Pin_1__PA__CFG1 EQU CYREG_UDB_PA2_CFG1
Pin_1__PA__CFG10 EQU CYREG_UDB_PA2_CFG10
Pin_1__PA__CFG11 EQU CYREG_UDB_PA2_CFG11
Pin_1__PA__CFG12 EQU CYREG_UDB_PA2_CFG12
Pin_1__PA__CFG13 EQU CYREG_UDB_PA2_CFG13
Pin_1__PA__CFG14 EQU CYREG_UDB_PA2_CFG14
Pin_1__PA__CFG2 EQU CYREG_UDB_PA2_CFG2
Pin_1__PA__CFG3 EQU CYREG_UDB_PA2_CFG3
Pin_1__PA__CFG4 EQU CYREG_UDB_PA2_CFG4
Pin_1__PA__CFG5 EQU CYREG_UDB_PA2_CFG5
Pin_1__PA__CFG6 EQU CYREG_UDB_PA2_CFG6
Pin_1__PA__CFG7 EQU CYREG_UDB_PA2_CFG7
Pin_1__PA__CFG8 EQU CYREG_UDB_PA2_CFG8
Pin_1__PA__CFG9 EQU CYREG_UDB_PA2_CFG9
Pin_1__PC EQU CYREG_GPIO_PRT2_PC
Pin_1__PC2 EQU CYREG_GPIO_PRT2_PC2
Pin_1__PORT EQU 2
Pin_1__PS EQU CYREG_GPIO_PRT2_PS
Pin_1__SHIFT EQU 0

; Clock_1
Clock_1__CTRL_REGISTER EQU CYREG_PERI_PCLK_CTL7
Clock_1__DIV_ID EQU 0x00000040
Clock_1__DIV_REGISTER EQU CYREG_PERI_DIV_16_CTL0
Clock_1__PA_DIV_ID EQU 0x000000FF

; Pin_Red
Pin_Red__0__DR EQU CYREG_GPIO_PRT3_DR
Pin_Red__0__DR_CLR EQU CYREG_GPIO_PRT3_DR_CLR
Pin_Red__0__DR_INV EQU CYREG_GPIO_PRT3_DR_INV
Pin_Red__0__DR_SET EQU CYREG_GPIO_PRT3_DR_SET
Pin_Red__0__HSIOM EQU CYREG_HSIOM_PORT_SEL3
Pin_Red__0__HSIOM_MASK EQU 0xF0000000
Pin_Red__0__HSIOM_SHIFT EQU 28
Pin_Red__0__INTCFG EQU CYREG_GPIO_PRT3_INTR_CFG
Pin_Red__0__INTR EQU CYREG_GPIO_PRT3_INTR
Pin_Red__0__INTR_CFG EQU CYREG_GPIO_PRT3_INTR_CFG
Pin_Red__0__INTSTAT EQU CYREG_GPIO_PRT3_INTR
Pin_Red__0__MASK EQU 0x80
Pin_Red__0__OUT_SEL EQU CYREG_UDB_PA3_CFG10
Pin_Red__0__OUT_SEL_SHIFT EQU 14
Pin_Red__0__OUT_SEL_VAL EQU 3
Pin_Red__0__PA__CFG0 EQU CYREG_UDB_PA3_CFG0
Pin_Red__0__PA__CFG1 EQU CYREG_UDB_PA3_CFG1
Pin_Red__0__PA__CFG10 EQU CYREG_UDB_PA3_CFG10
Pin_Red__0__PA__CFG11 EQU CYREG_UDB_PA3_CFG11
Pin_Red__0__PA__CFG12 EQU CYREG_UDB_PA3_CFG12
Pin_Red__0__PA__CFG13 EQU CYREG_UDB_PA3_CFG13
Pin_Red__0__PA__CFG14 EQU CYREG_UDB_PA3_CFG14
Pin_Red__0__PA__CFG2 EQU CYREG_UDB_PA3_CFG2
Pin_Red__0__PA__CFG3 EQU CYREG_UDB_PA3_CFG3
Pin_Red__0__PA__CFG4 EQU CYREG_UDB_PA3_CFG4
Pin_Red__0__PA__CFG5 EQU CYREG_UDB_PA3_CFG5
Pin_Red__0__PA__CFG6 EQU CYREG_UDB_PA3_CFG6
Pin_Red__0__PA__CFG7 EQU CYREG_UDB_PA3_CFG7
Pin_Red__0__PA__CFG8 EQU CYREG_UDB_PA3_CFG8
Pin_Red__0__PA__CFG9 EQU CYREG_UDB_PA3_CFG9
Pin_Red__0__PC EQU CYREG_GPIO_PRT3_PC
Pin_Red__0__PC2 EQU CYREG_GPIO_PRT3_PC2
Pin_Red__0__PORT EQU 3
Pin_Red__0__PS EQU CYREG_GPIO_PRT3_PS
Pin_Red__0__SHIFT EQU 7
Pin_Red__DR EQU CYREG_GPIO_PRT3_DR
Pin_Red__DR_CLR EQU CYREG_GPIO_PRT3_DR_CLR
Pin_Red__DR_INV EQU CYREG_GPIO_PRT3_DR_INV
Pin_Red__DR_SET EQU CYREG_GPIO_PRT3_DR_SET
Pin_Red__INTCFG EQU CYREG_GPIO_PRT3_INTR_CFG
Pin_Red__INTR EQU CYREG_GPIO_PRT3_INTR
Pin_Red__INTR_CFG EQU CYREG_GPIO_PRT3_INTR_CFG
Pin_Red__INTSTAT EQU CYREG_GPIO_PRT3_INTR
Pin_Red__MASK EQU 0x80
Pin_Red__PA__CFG0 EQU CYREG_UDB_PA3_CFG0
Pin_Red__PA__CFG1 EQU CYREG_UDB_PA3_CFG1
Pin_Red__PA__CFG10 EQU CYREG_UDB_PA3_CFG10
Pin_Red__PA__CFG11 EQU CYREG_UDB_PA3_CFG11
Pin_Red__PA__CFG12 EQU CYREG_UDB_PA3_CFG12
Pin_Red__PA__CFG13 EQU CYREG_UDB_PA3_CFG13
Pin_Red__PA__CFG14 EQU CYREG_UDB_PA3_CFG14
Pin_Red__PA__CFG2 EQU CYREG_UDB_PA3_CFG2
Pin_Red__PA__CFG3 EQU CYREG_UDB_PA3_CFG3
Pin_Red__PA__CFG4 EQU CYREG_UDB_PA3_CFG4
Pin_Red__PA__CFG5 EQU CYREG_UDB_PA3_CFG5
Pin_Red__PA__CFG6 EQU CYREG_UDB_PA3_CFG6
Pin_Red__PA__CFG7 EQU CYREG_UDB_PA3_CFG7
Pin_Red__PA__CFG8 EQU CYREG_UDB_PA3_CFG8
Pin_Red__PA__CFG9 EQU CYREG_UDB_PA3_CFG9
Pin_Red__PC EQU CYREG_GPIO_PRT3_PC
Pin_Red__PC2 EQU CYREG_GPIO_PRT3_PC2
Pin_Red__PORT EQU 3
Pin_Red__PS EQU CYREG_GPIO_PRT3_PS
Pin_Red__SHIFT EQU 7

; ADC_SAR_Seq_1_cy_psoc4_sar
ADC_SAR_Seq_1_cy_psoc4_sar__SAR_CTRL EQU CYREG_SAR_CTRL
ADC_SAR_Seq_1_cy_psoc4_sar__SAR_INTR EQU CYREG_SAR_INTR
ADC_SAR_Seq_1_cy_psoc4_sar__SAR_INTR_CAUSE EQU CYREG_SAR_INTR_CAUSE
ADC_SAR_Seq_1_cy_psoc4_sar__SAR_INTR_MASK EQU CYREG_SAR_INTR_MASK
ADC_SAR_Seq_1_cy_psoc4_sar__SAR_INTR_MASKED EQU CYREG_SAR_INTR_MASKED
ADC_SAR_Seq_1_cy_psoc4_sar__SAR_INTR_SET EQU CYREG_SAR_INTR_SET
ADC_SAR_Seq_1_cy_psoc4_sar__SAR_NUMBER EQU 0
ADC_SAR_Seq_1_cy_psoc4_sar__SAR_RANGE_COND EQU CYREG_SAR_RANGE_COND
ADC_SAR_Seq_1_cy_psoc4_sar__SAR_RANGE_INTR_MASK EQU CYREG_SAR_RANGE_INTR_MASK
ADC_SAR_Seq_1_cy_psoc4_sar__SAR_RANGE_INTR_MASKED EQU CYREG_SAR_RANGE_INTR_MASKED
ADC_SAR_Seq_1_cy_psoc4_sar__SAR_RANGE_INTR_SET EQU CYREG_SAR_RANGE_INTR_SET
ADC_SAR_Seq_1_cy_psoc4_sar__SAR_RANGE_THRES EQU CYREG_SAR_RANGE_THRES
ADC_SAR_Seq_1_cy_psoc4_sar__SAR_SAMPLE_CTRL EQU CYREG_SAR_SAMPLE_CTRL
ADC_SAR_Seq_1_cy_psoc4_sar__SAR_SAMPLE_TIME01 EQU CYREG_SAR_SAMPLE_TIME01
ADC_SAR_Seq_1_cy_psoc4_sar__SAR_SAMPLE_TIME23 EQU CYREG_SAR_SAMPLE_TIME23
ADC_SAR_Seq_1_cy_psoc4_sar__SAR_SATURATE_INTR_MASK EQU CYREG_SAR_SATURATE_INTR_MASK
ADC_SAR_Seq_1_cy_psoc4_sar__SAR_SATURATE_INTR_MASKED EQU CYREG_SAR_SATURATE_INTR_MASKED
ADC_SAR_Seq_1_cy_psoc4_sar__SAR_SATURATE_INTR_SET EQU CYREG_SAR_SATURATE_INTR_SET
ADC_SAR_Seq_1_cy_psoc4_sar__SAR_STATUS EQU CYREG_SAR_STATUS

; ADC_SAR_Seq_1_intClock
ADC_SAR_Seq_1_intClock__CTRL_REGISTER EQU CYREG_PERI_PCLK_CTL6
ADC_SAR_Seq_1_intClock__DIV_ID EQU 0x00000041
ADC_SAR_Seq_1_intClock__DIV_REGISTER EQU CYREG_PERI_DIV_16_CTL1
ADC_SAR_Seq_1_intClock__PA_DIV_ID EQU 0x000000FF

; ADC_SAR_Seq_1_IRQ
ADC_SAR_Seq_1_IRQ__INTC_CLR_EN_REG EQU CYREG_CM0_ICER
ADC_SAR_Seq_1_IRQ__INTC_CLR_PD_REG EQU CYREG_CM0_ICPR
ADC_SAR_Seq_1_IRQ__INTC_MASK EQU 0x8000
ADC_SAR_Seq_1_IRQ__INTC_NUMBER EQU 15
ADC_SAR_Seq_1_IRQ__INTC_PRIOR_MASK EQU 0xC0000000
ADC_SAR_Seq_1_IRQ__INTC_PRIOR_NUM EQU 3
ADC_SAR_Seq_1_IRQ__INTC_PRIOR_REG EQU CYREG_CM0_IPR3
ADC_SAR_Seq_1_IRQ__INTC_SET_EN_REG EQU CYREG_CM0_ISER
ADC_SAR_Seq_1_IRQ__INTC_SET_PD_REG EQU CYREG_CM0_ISPR

; Miscellaneous
CYDEV_BCLK__HFCLK__HZ EQU 48000000
CYDEV_BCLK__HFCLK__KHZ EQU 48000
CYDEV_BCLK__HFCLK__MHZ EQU 48
CYDEV_BCLK__SYSCLK__HZ EQU 48000000
CYDEV_BCLK__SYSCLK__KHZ EQU 48000
CYDEV_BCLK__SYSCLK__MHZ EQU 48
CYDEV_CHIP_DIE_GEN4 EQU 2
CYDEV_CHIP_DIE_LEOPARD EQU 1
CYDEV_CHIP_DIE_PANTHER EQU 13
CYDEV_CHIP_DIE_PSOC4A EQU 6
CYDEV_CHIP_DIE_PSOC5LP EQU 12
CYDEV_CHIP_DIE_UNKNOWN EQU 0
CYDEV_CHIP_FAMILY_PSOC3 EQU 1
CYDEV_CHIP_FAMILY_PSOC4 EQU 2
CYDEV_CHIP_FAMILY_PSOC5 EQU 3
CYDEV_CHIP_FAMILY_UNKNOWN EQU 0
CYDEV_CHIP_FAMILY_USED EQU CYDEV_CHIP_FAMILY_PSOC4
CYDEV_CHIP_JTAG_ID EQU 0x0E34119E
CYDEV_CHIP_MEMBER_3A EQU 1
CYDEV_CHIP_MEMBER_4A EQU 6
CYDEV_CHIP_MEMBER_4C EQU 10
CYDEV_CHIP_MEMBER_4D EQU 3
CYDEV_CHIP_MEMBER_4E EQU 5
CYDEV_CHIP_MEMBER_4F EQU 7
CYDEV_CHIP_MEMBER_4G EQU 2
CYDEV_CHIP_MEMBER_4H EQU 4
CYDEV_CHIP_MEMBER_4L EQU 9
CYDEV_CHIP_MEMBER_4M EQU 8
CYDEV_CHIP_MEMBER_5A EQU 12
CYDEV_CHIP_MEMBER_5B EQU 11
CYDEV_CHIP_MEMBER_UNKNOWN EQU 0
CYDEV_CHIP_MEMBER_USED EQU CYDEV_CHIP_MEMBER_4F
CYDEV_CHIP_DIE_EXPECT EQU CYDEV_CHIP_MEMBER_USED
CYDEV_CHIP_DIE_ACTUAL EQU CYDEV_CHIP_DIE_EXPECT
CYDEV_CHIP_REV_GEN4_ES EQU 17
CYDEV_CHIP_REV_GEN4_ES2 EQU 33
CYDEV_CHIP_REV_GEN4_PRODUCTION EQU 17
CYDEV_CHIP_REV_LEOPARD_ES1 EQU 0
CYDEV_CHIP_REV_LEOPARD_ES2 EQU 1
CYDEV_CHIP_REV_LEOPARD_ES3 EQU 3
CYDEV_CHIP_REV_LEOPARD_PRODUCTION EQU 3
CYDEV_CHIP_REV_PANTHER_ES0 EQU 0
CYDEV_CHIP_REV_PANTHER_ES1 EQU 1
CYDEV_CHIP_REV_PANTHER_PRODUCTION EQU 1
CYDEV_CHIP_REV_PSOC4A_ES0 EQU 17
CYDEV_CHIP_REV_PSOC4A_PRODUCTION EQU 17
CYDEV_CHIP_REV_PSOC5LP_ES0 EQU 0
CYDEV_CHIP_REV_PSOC5LP_PRODUCTION EQU 0
CYDEV_CHIP_REVISION_3A_ES1 EQU 0
CYDEV_CHIP_REVISION_3A_ES2 EQU 1
CYDEV_CHIP_REVISION_3A_ES3 EQU 3
CYDEV_CHIP_REVISION_3A_PRODUCTION EQU 3
CYDEV_CHIP_REVISION_4A_ES0 EQU 17
CYDEV_CHIP_REVISION_4A_PRODUCTION EQU 17
CYDEV_CHIP_REVISION_4C_PRODUCTION EQU 0
CYDEV_CHIP_REVISION_4D_PRODUCTION EQU 0
CYDEV_CHIP_REVISION_4E_PRODUCTION EQU 0
CYDEV_CHIP_REVISION_4F_PRODUCTION EQU 0
CYDEV_CHIP_REVISION_4F_PRODUCTION_256K EQU 0
CYDEV_CHIP_REVISION_4G_ES EQU 17
CYDEV_CHIP_REVISION_4G_ES2 EQU 33
CYDEV_CHIP_REVISION_4G_PRODUCTION EQU 17
CYDEV_CHIP_REVISION_4H_PRODUCTION EQU 0
CYDEV_CHIP_REVISION_4L_PRODUCTION EQU 0
CYDEV_CHIP_REVISION_4M_PRODUCTION EQU 0
CYDEV_CHIP_REVISION_5A_ES0 EQU 0
CYDEV_CHIP_REVISION_5A_ES1 EQU 1
CYDEV_CHIP_REVISION_5A_PRODUCTION EQU 1
CYDEV_CHIP_REVISION_5B_ES0 EQU 0
CYDEV_CHIP_REVISION_5B_PRODUCTION EQU 0
CYDEV_CHIP_REVISION_USED EQU CYDEV_CHIP_REVISION_4F_PRODUCTION
CYDEV_CHIP_REV_EXPECT EQU CYDEV_CHIP_REVISION_USED
CYDEV_CONFIG_READ_ACCELERATOR EQU 1
CYDEV_CONFIG_UNUSED_IO_AllowButWarn EQU 0
CYDEV_CONFIG_UNUSED_IO EQU CYDEV_CONFIG_UNUSED_IO_AllowButWarn
CYDEV_CONFIG_UNUSED_IO_AllowWithInfo EQU 1
CYDEV_CONFIG_UNUSED_IO_Disallowed EQU 2
CYDEV_CONFIGURATION_COMPRESSED EQU 1
CYDEV_CONFIGURATION_MODE_COMPRESSED EQU 0
CYDEV_CONFIGURATION_MODE EQU CYDEV_CONFIGURATION_MODE_COMPRESSED
CYDEV_CONFIGURATION_MODE_DMA EQU 2
CYDEV_CONFIGURATION_MODE_UNCOMPRESSED EQU 1
CYDEV_DEBUG_PROTECT_KILL EQU 4
CYDEV_DEBUG_PROTECT_OPEN EQU 1
CYDEV_DEBUG_PROTECT EQU CYDEV_DEBUG_PROTECT_OPEN
CYDEV_DEBUG_PROTECT_PROTECTED EQU 2
CYDEV_DEBUGGING_DPS_Disable EQU 3
CYDEV_DEBUGGING_DPS_SWD EQU 2
CYDEV_DEBUGGING_DPS EQU CYDEV_DEBUGGING_DPS_SWD
CYDEV_DEBUGGING_ENABLE EQU 1
CYDEV_DFT_SELECT_CLK0 EQU 10
CYDEV_DFT_SELECT_CLK1 EQU 11
CYDEV_HEAP_SIZE EQU 0x80
CYDEV_IMO_TRIMMED_BY_WCO EQU 0
CYDEV_PROJ_TYPE EQU 0
CYDEV_PROJ_TYPE_BOOTLOADER EQU 1
CYDEV_PROJ_TYPE_LAUNCHER EQU 5
CYDEV_PROJ_TYPE_LOADABLE EQU 2
CYDEV_PROJ_TYPE_LOADABLEANDBOOTLOADER EQU 4
CYDEV_PROJ_TYPE_MULTIAPPBOOTLOADER EQU 3
CYDEV_PROJ_TYPE_STANDARD EQU 0
CYDEV_STACK_SIZE EQU 0x0800
CYDEV_USE_BUNDLED_CMSIS EQU 1
CYDEV_VARIABLE_VDDA EQU 1
CYDEV_VDDA_MV EQU 3300
CYDEV_VDDD_MV EQU 3300
CYDEV_VDDR_MV EQU 3300
CYDEV_WDT_GENERATE_ISR EQU 1
CYIPBLOCK_m0s8bless_VERSION EQU 1
CYIPBLOCK_m0s8cpussv2_VERSION EQU 1
CYIPBLOCK_m0s8csd_VERSION EQU 1
CYIPBLOCK_m0s8ioss_VERSION EQU 1
CYIPBLOCK_m0s8lcd_VERSION EQU 2
CYIPBLOCK_m0s8lpcomp_VERSION EQU 2
CYIPBLOCK_m0s8peri_VERSION EQU 1
CYIPBLOCK_m0s8scb_VERSION EQU 2
CYIPBLOCK_m0s8srssv2_VERSION EQU 1
CYIPBLOCK_m0s8tcpwm_VERSION EQU 2
CYIPBLOCK_m0s8udbif_VERSION EQU 1
CYIPBLOCK_s8pass4al_VERSION EQU 1
CYDEV_BOOTLOADER_ENABLE EQU 0
    ENDIF
    END
